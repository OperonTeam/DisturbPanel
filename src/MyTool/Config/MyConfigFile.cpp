//--------------------------------------------------------------------------------------------------
//  Project : Disturbing Information
//  Edition : WioTerminal with Extend multi LCD-Monitor
//  File path : src/MyTool/Config/MyConfigFile.cpp
//  Copyright 2019, 2020, 2021, 2022, 2023 - OperonTeam
//--------------------------------------------------------------------------------------------------
#include "MyBase.h"
#include "MyTool.h"

//--------------------------------------------------------------------------------------------------
// ｊｓｏｎ管理クラス
//--------------------------------------------------------------------------------------------------
DynamicJsonDocument		MyJsonDoc(2048);								// JSON制御クラス

/**/
//--------------------------------------------------------------------------------------------------
// クラスインスタンスの開始処理
//--------------------------------------------------------------------------------------------------
_MyConfigFile::_MyConfigFile()
{
}
/**/
//--------------------------------------------------------------------------------------------------
// クラスインスタンスの終了処理（外部環境用のＪＳＯＮ定義ファイルアクセスメソッド）
//--------------------------------------------------------------------------------------------------
_MyConfigFile::~_MyConfigFile()
{
}
/**/
//--------------------------------------------------------------------------------------------------
// セットアップ情報ファイルの読み込み
//--------------------------------------------------------------------------------------------------
BOOL			_MyConfigFile::Initialize(CONST_CHAR *pszDate, CONST_CHAR *pszTime)
{
	//----------------------------------------------------------------------------------------------
	// ＪＡＲＶｉｓビルド日時を保存
	//----------------------------------------------------------------------------------------------
	this->dtJARVisBuild = DateTime(pszDate, pszTime);								// ＪＡＲＶｉｓビルド日時

	//----------------------------------------------------------------------------------------------
	// ＧＰＳ関係のセットアップ情報ファイルを読み込む　
	//----------------------------------------------------------------------------------------------
	if (this->LoadFile(MYCONFIG_GPS)) {												// ＧＰＳ定義ファイル
		this->MyGPSPointHome.dLat = this->GetDouble(MYCONFIG_GPS_HOMELAT);			// HOME_LAT
		this->MyGPSPointHome.dLng = this->GetDouble(MYCONFIG_GPS_HOMELNG);			// HOME_LNG
		//---
		if ((! this->MyGPSPointHome.dLat)||(! this->MyGPSPointHome.dLng)) {
			this->MyGPSPointHome.dLat = 35.658611;									// TokyoTower
			this->MyGPSPointHome.dLng = 139.745556;									// TokyoTower
		}
	}
//---
	//----------------------------------------------------------------------------------------------
	// ＮＥＴ関係のセットアップ情報ファイルを読み込む　
	//----------------------------------------------------------------------------------------------
	if (this->LoadFile(MYCONFIG_NET)) {												// ＮＥＴ定義ファイル
		this->bNET_Module	= this->GetBool(MYCONFIG_NET_MODULE);					// モジュール使用状態(1:使用/0:未使用)
		this->strNET_SSID	= this->GetString(MYCONFIG_NET_SSID);					// ＷｉＦｉ・ＳＳＩＤ
		this->strNET_PASS	= this->GetString(MYCONFIG_NET_PASS);					// ＷｉＦｉ・パスフレーズ
	}
//---
	//----------------------------------------------------------------------------------------------
	// ＡＭＧ関係のセットアップ情報ファイルを読み込む　
	//----------------------------------------------------------------------------------------------
	if (this->LoadFile(MYCONFIG_AMG)) {												// ＡＭＧ定義ファイル
		this->bAMG_Module	= this->GetBool(MYCONFIG_AMG_MODULE);					// モジュール使用状態(1:使用/0:未使用)
		this->bAMG_Face		= this->GetBool(MYCONFIG_AMG_FACE);						// 左右逆転モード(1:逆転/0:通常)
	}
//---
	//----------------------------------------------------------------------------------------------
	// ＩＭＵ関係のセットアップ情報ファイルを読み込む　
	//----------------------------------------------------------------------------------------------
	if (this->LoadFile(MYCONFIG_IMU)) {												// ＩＭＵ定義ファイル
		this->bIMU_Debug	= this->GetBool(MYCONFIG_IMU_DEBUG);					// 開発用モード使用状態(1:使用/0:未使用)
		this->bIMU_8Figure	= this->GetBool(MYCONFIG_IMU_8FIGURE);					// 磁気８の字キャリブレーション(1:使用/0:未使用)
		this->fIMU_MagDecl	= this->GetFloat(MYCONFIG_IMU_MAGDECL);					// 磁気情報赤緯（地理的なオフセット）
		this->My3DFMagBias	= this->Get3DFIMU(MYCONFIG_IMU_MAGBIAS);				// 磁気情報・バイアス
		this->My3DFMagScale	= this->Get3DFIMU(MYCONFIG_IMU_MAGSCALE);				// 磁気情報・スケール
	}
//---
	//----------------------------------------------------------------------------------------------
	// ＢＭＥ関係のセットアップ情報ファイルを読み込む　
	//----------------------------------------------------------------------------------------------
	if (this->LoadFile(MYCONFIG_BME)) {												// ＢＭＥ定義ファイル
		this->fBME_Offset	= this->GetFloat(MYCONFIG_BME_OFFSET);					// 温度センサーの補正値
	}
//---
	//----------------------------------------------------------------------------------------------
	// ＴＦＴ関係のセットアップ情報ファイルを読み込む　
	//----------------------------------------------------------------------------------------------
	if (this->LoadFile(MYCONFIG_TFT)) {												// ＴＦＴ定義ファイル
		this->lTFTSleepTime	= this->GetLong(MYCONFIG_TFT_SLEEPTIME);				// ＴＦＴ・自動消灯時間（秒）
		this->iTFTGeoOffset	= this->GetInt(MYCONFIG_TFT_GEOOFFSET);					// ＴＦＴ・磁気方位描画オフセット値
		for (INT i = 0; i < MYCONFIG_TFT_COLOR_NUM; i++) {							// ＴＦＴ・速度別表示・カラーデータ数
			this->iTFTColorSpeed[i][0] = this->GetInt(MYCONFIG_TFT_COLOR_SPEED, i);	// ＴＦＴ・速度別表示・移動速度
			this->iTFTColorSpeed[i][1] = this->GetInt(MYCONFIG_TFT_COLOR_NO, i);	// ＴＦＴ・速度別表示・カラー番号
		}
	}
//---
	//----------------------------------------------------------------------------------------------
	// メモリ解放
	//----------------------------------------------------------------------------------------------
	MyJsonDoc.clear();

	return	MY_TRUE;
}
//---
/**/
INT			_MyConfigFile::GetSysConfigSpeedColor(LONG lSpeed){

	for (INT i = 0; i < MYCONFIG_TFT_COLOR_NUM; i++) {
		if (this->iTFTColorSpeed[i][0] <= (INT)lSpeed) {
			return	this->iTFTColorSpeed[i][1];
		}
	}
	return	-1;
}
/**/
//--------------------------------------------------------------------------------------------------
// クラスインスタンスの終了処理（外部環境用のＪＳＯＮ定義ファイルアクセスメソッド）
//--------------------------------------------------------------------------------------------------
BOOL		_MyConfigFile::LoadFile(String strSetupFile)
{
	//------------------------------------------------------------------------------------------
	// 外部環境用定義ファイルをオープンする
	//------------------------------------------------------------------------------------------
	BOOL	bRet = MY_FALSE;
	CHAR	szBuff[2048];
	sprintf(szBuff, MYSETP_FILEPATH_FORMAT, strSetupFile.c_str());
	SDFile	MySDFile = (SDFile)MYDEV_SD.open(szBuff, FILE_READ);
	if (MySDFile) {
		//--------------------------------------------------------------------------------------
		// 外部環境用定義ファイルを読み込む（実装が面倒だから1024バイト以内に限る）
		//--------------------------------------------------------------------------------------
		INT		iReadSize = MySDFile.read(szBuff, sizeof(szBuff));
		MySDFile.close();
		//---
		if ((0 < iReadSize)&&(iReadSize < sizeof(szBuff))) {
			//----------------------------------------------------------------------------------
			// 期待通りバッファサイズ以内で読み取れた場合は、ｊｓｏｎデコードを実施する
			//----------------------------------------------------------------------------------
			MyJsonDoc.clear();
			DeserializationError error = deserializeJson(MyJsonDoc, szBuff);
			if (! error ) {
					//--------------------------------------------------------------------------
					// このルートが正常終了ルート（ｊｓｏｎデコードに成功した場合）
					//--------------------------------------------------------------------------
					bRet = MY_TRUE;
			}
		}
	}
	return	bRet;
}
/**/
//--------------------------------------------------------------------------------------------------
// 外部環境用のＪＳＯＮ定義ファイルアクセスメソッド・ＢＯＯＬ型データ取得処理
//--------------------------------------------------------------------------------------------------
BOOL		_MyConfigFile::GetBool(String strKeyWord)
{
	return	MyJsonDoc[strKeyWord].as<BOOL>();
}
/**/
//--------------------------------------------------------------------------------------------------
// 外部環境用のＪＳＯＮ定義ファイルアクセスメソッド・ＩＮＴ型データ取得処理
//--------------------------------------------------------------------------------------------------
INT			_MyConfigFile::GetInt(String strKeyword)
{
	return	MyJsonDoc[strKeyword].as<INT>();
}
/**/
//--------------------------------------------------------------------------------------------------
// 外部環境用のＪＳＯＮ定義ファイルアクセスメソッド・ＩＮＴ型データ取得処理
//--------------------------------------------------------------------------------------------------
INT			_MyConfigFile::GetInt(String strKeyword, INT iIndex)
{
	return	MyJsonDoc[strKeyword + String(iIndex)].as<INT>();
}
/**/
//--------------------------------------------------------------------------------------------------
// 外部環境用のＪＳＯＮ定義ファイルアクセスメソッド・ＬＯＮＧ型データ取得処理
//--------------------------------------------------------------------------------------------------
LONG		_MyConfigFile::GetLong(String strKeyword)
{
	return	MyJsonDoc[strKeyword].as<LONG>();
}
/**/
//--------------------------------------------------------------------------------------------------
// 外部環境用のＪＳＯＮ定義ファイルアクセスメソッド・ＦＬＯＡＴ型データ取得処理
//--------------------------------------------------------------------------------------------------
FLOAT		_MyConfigFile::GetFloat(String strKeyword)
{
	return	MyJsonDoc[strKeyword].as<FLOAT>();
}
/**/
//--------------------------------------------------------------------------------------------------
// 外部環境用のＪＳＯＮ定義ファイルアクセスメソッド・ＤＯＵＢＬＥ型データ取得処理
//--------------------------------------------------------------------------------------------------
DOUBLE		_MyConfigFile::GetDouble(String strKeyword)
{
	return	MyJsonDoc[strKeyword].as<DOUBLE>();
}
/**/
//--------------------------------------------------------------------------------------------------
// 外部環境用のＪＳＯＮ定義ファイルアクセスメソッド・Ｓｔｒｉｎｇ型データ取得処理
//--------------------------------------------------------------------------------------------------
String		_MyConfigFile::GetString(String strKeyword)
{
	return	MyJsonDoc[strKeyword].as<String>();
}
/**/
//--------------------------------------------------------------------------------------------------
// 外部環境用のＪＳＯＮ定義ファイルアクセスメソッド・Ｍｙ３ＤＦＩＭＵ型データ取得処理
//--------------------------------------------------------------------------------------------------
_My3DFIMU	_MyConfigFile::Get3DFIMU(String strKeyword)
{
	_My3DFIMU	My3DFIMU;
	My3DFIMU.fRoll	= this->GetFloat(strKeyword + ADD_ROLL);
	My3DFIMU.fPitch	= this->GetFloat(strKeyword + ADD_PITCH);
	My3DFIMU.fYaw	= this->GetFloat(strKeyword + ADD_YAW);
	return	My3DFIMU;
}
/**/
//--------------------------------------------------------------------------------------------------
// テスト用ダンプ処理
//--------------------------------------------------------------------------------------------------
VOID		_MyConfigFile::DumpTest(VOID)
{
	MY_LOG("_MyConfigFile::DumpTest Start\n");
	MY_LOG("---GPS---\n");
	MY_LOG("ＧＰＳ・ランドマーク座標	:%lf, %lf\n", this->MyGPSPointHome.dLat, this->MyGPSPointHome.dLng);
	MY_LOG("---NET---\n");
	MY_LOG("ＮＥＴ・モジュール使用状態(1:使用/0:未使用)	:%d\n", this->bNET_Module);
	MY_LOG("ＮＥＴ・ＷｉＦｉＳＳＩＤ	:[%s]\n", this->strNET_SSID.c_str());
	MY_LOG("ＮＥＴ・ＷｉＦｉパスフレーズ:[%s]\n", this->strNET_PASS.c_str());
	MY_LOG("---AMG---\n");
	MY_LOG("ＡＭＧ・モジュール使用状態(1:使用/0:未使用)	:%d\n", this->bAMG_Module);
	MY_LOG("ＡＭＧ・左右逆転モード(1:逆転/0:通常)	:%d\n", this->bAMG_Face);
	MY_LOG("---IMU---\n");
	MY_LOG("ＩＭＵ・開発用モード使用状態(1:使用/0:未使用):%d\n", this->bIMU_Debug);
	MY_LOG("ＩＭＵ・磁気８の字キャリブレーション(1:使用/0:未使用):%d\n", this->bIMU_8Figure);
	MY_LOG("ＩＭＵ・磁気情報赤緯（地理的なオフセット）:%f\n", this->fIMU_MagDecl);
	MY_LOG("ＩＭＵ・磁気情報バイアス	:%f, %f, %f\n", this->My3DFMagBias.fRoll, this->My3DFMagBias.fPitch, this->My3DFMagBias.fYaw);
	MY_LOG("ＩＭＵ・磁気情報スケール	:%f, %f, %f\n", this->My3DFMagScale.fRoll, this->My3DFMagScale.fPitch, this->My3DFMagScale.fYaw);
	MY_LOG("---BME---\n");
	MY_LOG("ＢＭＥ・温度センサーの補正値	:%f\n", this->fBME_Offset);
	MY_LOG("---TFT---\n");
	MY_LOG("ＴＦＴ・パネル自動消灯時間（秒）	:%ld\n", this->lTFTSleepTime);
	MY_LOG("ＴＦＴ・磁気方位描画オフセット値	:%d\n", this->iTFTGeoOffset);
	for (INT i = 0; i < MYCONFIG_TFT_COLOR_NUM; i++) {
		MY_LOG("ＴＦＴ・速度別表示・[%d] 速度[%3d] カラー[%d]\n", i, this->iTFTColorSpeed[i][0], this->iTFTColorSpeed[i][1]);
	}
	MY_LOG("_MyConfigFile::DumpTest End\n");
//---
}
/*-- End Of File --*/
