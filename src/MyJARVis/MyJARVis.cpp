//--------------------------------------------------------------------------------------------------
//  Project : Disturbing Information
//  Edition : WioTerminal with Extend multi LCD-Monitor
//  File path : src/MyJARVis/MyJARVis.cpp
//  Copyright 2019, 2020, 2021, 2022, 2023 - OperonTeam
//--------------------------------------------------------------------------------------------------
#include "MyBase.h"
#include "MyDevice.h"
#include "MyJARVis.h"

//--------------------------------------------------------------------------------------------------
// クラス初期メソッド
//--------------------------------------------------------------------------------------------------
_MyJARVis::_MyJARVis()
{
}
/**/
//--------------------------------------------------------------------------------------------------
// クラス終了メソッド
//--------------------------------------------------------------------------------------------------
_MyJARVis::~_MyJARVis()
{
}
/**/
//--------------------------------------------------------------------------------------------------
// 情報分析処理クラス
//	Initialize					: 統計情報の初期化
//	AnalyzeFDRRec				: 統計情報の更新（メイン処理）
//--------------------------------------------------------------------------------------------------
VOID		_MyJARVis::Initialize(_MyDevice *pMyDevice)
{
	//----------------------------------------------------------------------------------------------
	// パネル描画用の長期系バッファをクリアする
	//----------------------------------------------------------------------------------------------
	this->MyCircularShortBuff.clear();									// 描画用短期系バッファ
	this->MyCircularLongBuff.clear();									// 描画用長期系バッファ
	this->dtLongBuffLastUpdate		= DateTime(2000, 1, 1, 0, 0, 0);	// 描画用長期系バッファ最終更新日時

	//----------------------------------------------------------------------------------------------
	// JARVis分析・統計情報クラスを初期化する
	//----------------------------------------------------------------------------------------------
	this->MyJARVisAnalyze.Initialize(pMyDevice);
}
/**/
//--------------------------------------------------------------------------------------------------
// FDRRec情報から、JARVis内で保有する各種統計情報を更新する。
//--------------------------------------------------------------------------------------------------
BOOL		_MyJARVis::AnalyzeFDRRec(_MyFDRBodyRec *pMyFDRBodyRecNow, _MyDevice *pMyDevice)
{
	//----------------------------------------------------------------------------------------------
	// JARVis 統計情報クラスを呼び出す
	// センサーから得られた値が妥当な場合、MY_TRUEが返却される。
	//----------------------------------------------------------------------------------------------
	BOOL	bRet = this->MyJARVisAnalyze.AnalyzeFDRRec(pMyFDRBodyRecNow, pMyDevice);
	if (bRet == MY_TRUE) {
		//------------------------------------------------------------------------------------------
		// 一定時間毎の平均移動速度を求め、速度遷移情報を保存する
		//------------------------------------------------------------------------------------------
		DateTime	dtNow = pMyFDRBodyRecNow->GetGPSDateTime();
		TimeSpan	tsSpan = dtNow - this->dtLongBuffLastUpdate;
//MY_LOG("Now[%4d/%02d/%02d %02d:%02d:%2d - ", dtNow.year(), dtNow.month(), dtNow.day(), dtNow.hour(), dtNow.minute(), dtNow.second());
//MY_LOG("CHK[%4d/%02d/%02d %02d:%02d:%2d - ", this->dtLongBuffLastUpdate.year(), this->dtLongBuffLastUpdate.month(), this->dtLongBuffLastUpdate.day(), this->dtLongBuffLastUpdate.hour(), this->dtLongBuffLastUpdate.minute(), this->dtLongBuffLastUpdate.second());
//MY_LOG("AND[%d]\n", tsSpan.totalseconds());
		if ((tsSpan.totalseconds() >= 2)||(tsSpan.totalseconds() < 0)) {
			//--------------------------------------------------------------------------------------
			// 短期系の情報を抽出して、長期系メモリに保存する
			//--------------------------------------------------------------------------------------
			this->MakeLongTermBuff(pMyDevice);
			this->dtLongBuffLastUpdate = dtNow;
		}
		//------------------------------------------------------------------------------------------
		// 短期系メモリに保存する
		//------------------------------------------------------------------------------------------
		this->MakeShortTermBuff(pMyFDRBodyRecNow, pMyDevice);
	}
	return	bRet;
}
/**/
//--------------------------------------------------------------------------------------------------
// ＪＡＲＶｉｓメッセージを取得する
//--------------------------------------------------------------------------------------------------
BOOL		_MyJARVis::QueJARVisMessage(_MyDevice *pMyDevice, String *pstrMessage)
{
	//----------------------------------------------------------------------------------------------
	// 通知メッセージ情報を初期化する
	//----------------------------------------------------------------------------------------------
	BOOL	bRetFlag = MY_FALSE;									// スクロール種別（ON or OFF）
	*pstrMessage = "";												// 通知メッセージを初期化

	//----------------------------------------------------------------------------------------------
	// 基本情報（現在デバイス状態）を文字列で取得する
	//----------------------------------------------------------------------------------------------
	for( INT iDevID = 0; iDevID < _MyDEV_ID::MY_DEVID_COUNT; iDevID++) {
		//------------------------------------------------------------------------------------------
		// 現在のデバイス状態が、MY_DEVSTAT_OPEN以外の場合は、メッセージを連結する。
		//------------------------------------------------------------------------------------------
		String	strDevStatus = "";
		_MyDEV_STAT	MyDevStat = this->MyMessage.GetDeviceInfoMsg(pMyDevice, (_MyDEV_ID)iDevID, &strDevStatus);
		if (MyDevStat != _MyDEV_STAT::MY_DEVSTAT_OPEN) {
			//--------------------------------------------------------------------------------------
			// 【スクロール有り】／【GPS衛星探索中】 / ・・・
			//--------------------------------------------------------------------------------------
			if (pstrMessage->length() > 0)	pstrMessage->concat(F(" / "));
			pstrMessage->concat(strDevStatus);
			bRetFlag = MY_TRUE;
		}
	}
	return	bRetFlag;
}

/**/
/*
*/
/**/
//--------------------------------------------------------------------------------------------------
// 簡易統計情報・分析更新処理
//	MakeShortTermBuff			: 短期系情報を生成・挿入する
//	MakeLongTermBuff			: 長期系情報を生成・挿入する
//--------------------------------------------------------------------------------------------------
//--------------------------------------------------------------------------------------------------
// 短期系情報を生成・挿入する
//--------------------------------------------------------------------------------------------------
VOID				_MyJARVis::MakeShortTermBuff(_MyFDRBodyRec *pMyFDRBodyRec, _MyDevice *pMyDevice)
{
	//----------------------------------------------------------------------------------------------
	// 短期系データバッファの記録情報を生成する
	//----------------------------------------------------------------------------------------------
	_MyShortTermRec	MyShortTermRec;
	MyShortTermRec.fGPSSpeed			= pMyFDRBodyRec->GetGPSSpeed();		// 移動速度
	MyShortTermRec.My3DFIMUACCEL		= pMyFDRBodyRec->GetIMUACCELData();	// 加速度
	//---
	//----------------------------------------------------------------------------------------------
	// 生成した短期系データを、短期系データバッファに挿入する
	//----------------------------------------------------------------------------------------------
	this->MyCircularShortBuff.push(MyShortTermRec);
}
//--------------------------------------------------------------------------------------------------
// 長期系情報を生成・挿入する
//--------------------------------------------------------------------------------------------------
VOID				_MyJARVis::MakeLongTermBuff(_MyDevice *pMyDevice)
{
	//----------------------------------------------------------------------------------------------
	// 短期系データバッファの記録情報から、長期系データ（平均速度）を生成する
	// ＃長期系データバッファはSHORT型で、10倍したデータ値が保存されている。
	//----------------------------------------------------------------------------------------------
	FLOAT	fSpeed = (FLOAT)0.0;
	INT		iAliveCount = this->MyCircularShortBuff.size();
	for (INT iIndex = 0; iIndex < iAliveCount; iIndex++) {
		//------------------------------------------------------------------------------------------
		// 短期系データ（移動速度）を取得して、加算する
		//------------------------------------------------------------------------------------------
		fSpeed += this->MyCircularShortBuff[iIndex].fGPSSpeed;
	}
	fSpeed = ceil((fSpeed * 10.0) / iAliveCount);
	//---
	//----------------------------------------------------------------------------------------------
	// 短期系データバッファを初期化する
	//----------------------------------------------------------------------------------------------
	this->MyCircularShortBuff.clear();
	//---
	//----------------------------------------------------------------------------------------------
	// 生成した長期系データ（平均速度）を、長期系データバッファに挿入する
	//----------------------------------------------------------------------------------------------
	this->MyCircularLongBuff.push((SHORT)fSpeed);
}
/*-- End Of File --*/
