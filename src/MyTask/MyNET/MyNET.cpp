//--------------------------------------------------------------------------------------------------
//  Project : Disturbing Information
//  Edition : WioTerminal with Extend multi LCD-Monitor
//  File path : src/MyTask/MyNET/MyNET.cpp
//  Copyright 2019, 2020, 2021, 2022, 2023 - OperonTeam
//--------------------------------------------------------------------------------------------------
#include "MyBase.h"
#include "MyDevice.h"
#include "MyJARVis.h"

//--------------------------------------------------------------------------------------------------
// クラス初期メソッド
//--------------------------------------------------------------------------------------------------
_MyNET::_MyNET()
{
	this->strTargetURL = "";
}
/**/
//--------------------------------------------------------------------------------------------------
// クラス終了メソッド
//--------------------------------------------------------------------------------------------------
_MyNET::~_MyNET()
{
}
/**/
//--------------------------------------------------------------------------------------------------
// ＮＥＴクラスを初期化する
//--------------------------------------------------------------------------------------------------
_MyTask::_MyTaskRet	_MyNET::MyBegin(
_MyDevice			*pMyDevice,
_MyJARVis			*pMyJARVis)
{
	//----------------------------------------------------------------------------------------------
	// 本モジュールの設定値を取得します。
	//----------------------------------------------------------------------------------------------
//---
	_MyDEV_STAT	MyDevStat = _MyDEV_STAT::MY_DEVSTAT_FAIL;						// ＷｉＦｉ未接続＋サーバ未接続
	_MyTaskRet	MyTaskRet = _MyTaskRet::MY_DEVICE_STATUS_NOTOPEN;				// 次回処理も、ＢＥＧＩＮ
//---
	if (! MyGlobalTool.MyConfigFile.bNET_Module) {								// ＮＥＴ・モジュール使用状態(1:使用/0:未使用)
		//------------------------------------------------------------------------------------------
		// モジュールの利用を行わない場合は、良い感じに自タスクを終了する　
		//------------------------------------------------------------------------------------------
		MyDevStat = _MyDEV_STAT::MY_DEVSTAT_OPEN;								// ＷｉＦｉ接続完了＋サーバ接続
		MyTaskRet = _MyTaskRet::MY_DEVICE_STATUS_CLOSE;							// 次回処理は、タスク終了
	} else {
		//------------------------------------------------------------------------------------------
		// 初回接続の場合、ＷｉＦｉ（クライアント）接続を行う
		//------------------------------------------------------------------------------------------
		MYDEV_WiFi.begin(MyGlobalTool.MyConfigFile.strNET_SSID.c_str(),			// ＮＥＴ・ＷｉＦｉＳＳＩＤ
						 MyGlobalTool.MyConfigFile.strNET_PASS.c_str());		// ＮＥＴ・ＷｉＦｉＰＡＳＳ
		if (MYDEV_WiFi.status() == WL_CONNECTED) {
			//--------------------------------------------------------------------------------------
			// ＷｉＦｉ接続が完了した場合は、接続情報を退避する
			//--------------------------------------------------------------------------------------
			this->strTargetIP	= MYDEV_WiFi.gatewayIP().toString();
			this->strTargetURL	= "http://" + this->strTargetIP + "/";
			//---
			MyDevStat = _MyDEV_STAT::MY_DEVSTAT_LOST;							// ＷｉＦｉ接続完了＋サーバ未接続
			MyTaskRet = _MyTaskRet::MY_DEVICE_STATUS_SETUP;						// 次回処理は、ＳＥＴＵＰ
		}
	}
//---
	//----------------------------------------------------------------------------------------------
	// デバイス管理クラスにタスク状態を通知する。
	//----------------------------------------------------------------------------------------------
	pMyDevice->SetDeviceInfo(_MyDEV_ID::MY_DEVID_NET, MyDevStat);

	//----------------------------------------------------------------------------------------------
	// 基底（タスク）管理クラスにセットアップを返却する
	//----------------------------------------------------------------------------------------------
	return	MyTaskRet;
}
/**/
//--------------------------------------------------------------------------------------------------
// ＮＥＴクラスの情報を更新する（センサーからの受信情報を解析する）
//--------------------------------------------------------------------------------------------------
_MyTask::_MyTaskRet	_MyNET::MyUpdate(
_MyDevice			*pMyDevice,
_MyJARVis			*pMyJARVis)
{
	//----------------------------------------------------------------------------------------------
	// ＷｉＦｉ接続状態をチェック（クライアント・モード）
	//----------------------------------------------------------------------------------------------
	_MyTaskRet	MyTaskRet = _MyTaskRet::MY_DEVICE_STATUS_OPEN;
//
	//----------------------------------------------------------------------------------------------
	// ｈｔｔｐ（８０番）でＧＥＴコマンドを送信します（->暇があったらhttps + POSTに変更する）
	//----------------------------------------------------------------------------------------------
MY_LOG("NET begin(%s)\n", this->strTargetURL.c_str());
	HTTPClient		MyHTTPClient;								// My TCP Handle
	MyHTTPClient.begin(this->strTargetURL);						// HTTP
	INT		iHttpRet = MyHTTPClient.GET();
//
	if(iHttpRet != HTTP_CODE_OK) {
		//------------------------------------------------------------------------------------------
		// ｈｔｔｐサーバの戻り値次第、、、、（まだサーバ側のアーキテクチャ決めていないの）　
		//------------------------------------------------------------------------------------------
		MY_LOG("[HTTP] GET... failed, error: %s\n", MyHTTPClient.errorToString(iHttpRet).c_str());
		MyTaskRet = _MyTaskRet::MY_DEVICE_STATUS_SETUP;
	} else {
		//------------------------------------------------------------------------------------------
		// この辺りは、SEEED本家ライブラリのexsamplesコードから引っ張ってきた。
		//------------------------------------------------------------------------------------------
		INT		len = MyHTTPClient.getSize();					// get lenght of document (is -1 when Server sends no Content-Length header)
		uint8_t buff[128] = { 0 };								// create buffer for read
		WiFiClient * stream = MyHTTPClient.getStreamPtr();		// get tcp stream

		//------------------------------------------------------------------------------------------
		// このロジックがポイント
		//------------------------------------------------------------------------------------------
		while(MyHTTPClient.connected() && (len > 0 || len == -1)) {
			size_t size = stream->available();					// get available data size
			if(size) {
				//----------------------------------------------------------------------------------
				// 受信ストリームからデータを取得して、残りの受信サイズを算出する
				//----------------------------------------------------------------------------------
				int c = stream->readBytes(buff, ((size > sizeof(buff)) ? sizeof(buff) : size));		// read up to 128 byte
				if(len > 0)		len -= c;
				//
				//----------------------------------------------------------------------------------
				// 本来は、ここで受信データのパースを行う
				//----------------------------------------------------------------------------------
				MY_HEXDUMP((VOID *)buff, c, "NetStreamz");
			}
			delay(1);
		}
		MY_LOG("\n[HTTP] connection closed or file end.\n");
	}
	MyHTTPClient.end();
//---
	//----------------------------------------------------------------------------------------------
	// タスク状態を通知する
	//----------------------------------------------------------------------------------------------
MY_LOG("MyNET:MyUpdate EXIT\n");
	return	MyTaskRet;
}
/**/
//--------------------------------------------------------------------------------------------------
// ＮＥＴクラスをセットアップする
//--------------------------------------------------------------------------------------------------
_MyTask::_MyTaskRet	_MyNET::MySetup(
_MyDevice			*pMyDevice,
_MyJARVis			*pMyJARVis)
{
	//----------------------------------------------------------------------------------------------
	// 信頼出来る接続状態を得る為、接続完了時に保存したＷｉＦｉ－ＡＰに対してＩＣＭＰを送信する。
	// ICMPを送信する回数を指定可能ですが、送信回数を縮小すると100% lostする模様（詳細未調査）
	//----------------------------------------------------------------------------------------------
	_MyDEV_STAT	MyDevStat = _MyDEV_STAT::MY_DEVSTAT_LOST;						// ＷｉＦｉ接続＋サーバ未接続
	_MyTaskRet	MyTaskRet =	_MyTaskRet::MY_DEVICE_STATUS_SETUP;					// 次回処理も、ＳＥＴＵＰ
	//---
	if (Ping.ping(this->strTargetIP.c_str()) == MY_TRUE) {
		//------------------------------------------------------------------------------------------
		// ＥＣＨＯを受信した場合は、正常ルート（ＷｉＦｉ接続完了＆Ｐｉｎｇ応答受信）
		//------------------------------------------------------------------------------------------
		MyDevStat = _MyDEV_STAT::MY_DEVSTAT_OPEN;								// ＷｉＦｉ接続完了（サーバ接続）
		MyTaskRet = _MyTaskRet::MY_DEVICE_STATUS_OPEN;							// 次回処理は、ＵＰＤＡＴＥ処理
	} else {
		//------------------------------------------------------------------------------------------
		// ＥＣＨＯが受信出来ない場合は、ＷｉＦｉ（クライアントの）再接続を行う
		//------------------------------------------------------------------------------------------
		if (MYDEV_WiFi.reconnect() != MY_TRUE) {
			MyDevStat = _MyDEV_STAT::MY_DEVSTAT_FAIL;							// ＷｉＦｉ未接続＋サーバ未接続
		}
	}
//---
	//----------------------------------------------------------------------------------------------
	// デバイス管理クラスにタスク状態を通知する。
	//----------------------------------------------------------------------------------------------
	pMyDevice->SetDeviceInfo(_MyDEV_ID::MY_DEVID_NET, MyDevStat);
	return	MyTaskRet;
}
/**/
//--------------------------------------------------------------------------------------------------
// ＮＥＴクラスの状態を出力する
//--------------------------------------------------------------------------------------------------
VOID				_MyNET::MyDump(VOID)
{
	//----------------------------------------------------------------------------------------------
	// ＢＬＥタスクの基本情報をダンプ出力する
	//----------------------------------------------------------------------------------------------
	MY_TRACE("Start");
	this->MyDumpBase();
	MY_TRACE("Exit");
}
/*-- End Of File --*/