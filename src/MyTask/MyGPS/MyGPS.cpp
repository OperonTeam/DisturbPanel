//--------------------------------------------------------------------------------------------------
//  Project : Disturbing Information
//  Edition : WioTerminal with Extend multi LCD-Monitor
//  File path : src/MyTask/MyGPS/MyGPS.cpp
//  Copyright 2019, 2020, 2021, 2022, 2023 - OperonTeam
//--------------------------------------------------------------------------------------------------
#include "MyBase.h"
#include "MyDevice.h"
#include "MyJARVis.h"

//--------------------------------------------------------------------------------------------------
//	現在利用しているGPSセンサーのドキュメントは、以下から見つけました。
//	https://docs.m5stack.com/en/unit/gps
//	http://www.icofchina.com/d/file/xiazai/2017-05-02/ea0cdd3d81eeebcc657b5dbca80925ee.pdf
//
//	センサーの設定条件
//	・センサーとの通信は、GROVE(シリアル/9600bps)
//	・取得するデータは、
//		GNRMC : 1秒間に 9回 : 77 x 9 -> 693 Byte 
//		GNGGA : 1秒間に 1回 : 82 x 1 ->  82 Byte 
//
//	         1         2         3         4         5         6         7
//	12345678901234567890123456789012345678901234567890123456789012345678901234567890
//	$GNRMC,051001.000,A,3435.3923,N,13541.1784,E,0.00,332.19,240715,,,A*78@@			Max77 Byte(With CR+LF)
//	$GNGGA,051000.000,3435.3923,N,13541.1784,E,1,12,0.6,47.5,M,34.8,M,,0000*66@@		Max82 Byte(With CR+LF)
//
//	GNRMC : 1秒間に 9回 : 77 x 9 -> 693 Byte 
//	GNGGA : 1秒間に 1回 : 82 x 1 ->  82 Byte 
//  -----------------------------------------
//          1秒間に                 775 Byte(7750 bit/秒)	(*)UARTは、Start:1 + Data:8 + Stop:1 + NonParity -> 10bit
//	
//　上記はセンサーから連続でデータが送信される場合の試算値ですが、10Hzでも9600bpsでギリギリ
//	（7750 < 9600)受信可能な試算値です。（駄目だったら、修正するか、、、）
//	
//--------------------------------------------------------------------------------------------------
//	GPS NMEAフォーマット
//	今回利用しているのは、GNRMC,GNGGAの2つだけ
//	$GNRMC
//	+-------+---------------------------------------------------------------------------------------
//	|$GNRMC	| Recommended Minimum Course Response Message(Max77Byte)
//	+-------+---------------------------------------------------------------------------------------
//	|	フォーマット:	$GNRMC,092403.307,A,4307.3280,N,14127.0980,E,000.0,240.3,150717,,,A*6A<CR><LF>
//	|	パラメータ	:	+---------------+----------------------------------------------------------+
//	|					|092403.307		|測位(UTC)時刻　|09時24分03秒307
//	|					+---------------+---------------+------------------------------------------+
//	|					|A              |測位状態		|A:単独測位中またはDGPS測位中
//	|					|				|				|V:未測位	単独測位中/DGPS測位中
//	|					+---------------+---------------+------------------------------------------+
//	|					|4307.3280		|緯度			|dddmm.mmmm (10進)	緯度 43.07328
//	|					+---------------+---------------+------------------------------------------+
//	|					|N				|北緯、南緯		|N:北緯、S:南緯
//	|					+---------------+---------------+------------------------------------------+
//	|					|14127.0980		|経度			|dddmm.mmmm (10進)	経度 141.270980
//	|					+---------------+---------------+------------------------------------------+
//	|					|E				|東径、西径		|E:東経、W:西経
//	|					+---------------+---------------+------------------------------------------+
//	|					|000.0			|速度			|(000.0～270.0、単位：ノット)速度 0 Knot
//	|					+---------------+---------------+------------------------------------------+
//	|					|240.3			|進行方向		|(000.0～359.9、単位：度)	240.3度
//	|					+---------------+---------------+------------------------------------------+
//	|					|150717			|日付(ddmmyy)	|日付 2017年7月15日
//	|					+---------------+---------------+------------------------------------------+
//	|					|xxx.x			|磁気偏差		|(000.0～180.0、単位:度)	0(なし)
//	|					+---------------+---------------+------------------------------------------+
//	|					|x				|磁気偏差		|E:磁気偏差が東より、W:磁気偏差が西より
//	|					+---------------+---------------+------------------------------------------+
//	|					|A				|測位mode		|N:未測位、A:単独測位、D:DGPS測位
//	|					+---------------+---------------+------------------------------------------+
//	|					|*6A			|チェックサム	|チェックサム:6A
//	|					+---------------+----------------------------------------------------------+
//	|					|<CR><LF>	文字キャリッジリターン + ラインフィード
//	|					+---------------+----------------------------------------------------------+
//	+-----------------------------------------------------------------------------------------------
//
//	$GNGGA
//	+-------+---------------------------------------------------------------------------------------
//	|$GNGGA	| Position Response Message(Max82byte)
//	+-------+---------------------------------------------------------------------------------------
//	|	フォーマット:	$GNGGA,092403,4307.328,N,14127.098,E,1,08,01.96,0013,M,0032,M,,<CR><LF>
//	|	パラメータ	:	+---------------+----------------------------------------------------------+
//	|					|092403.20		|協定世界時(UTC)|hhmmss.ss	UTC時刻:09時24分03秒20
//	|					+---------------+---------------+------------------------------------------+
//	|					|4307.328		|緯度			|dddmm.mmmm (10進)	緯度:43.073280
//	|					+---------------+---------------+------------------------------------------+
//	|					|N				|北緯南緯		|N:北緯、S:南緯
//	|					+---------------+---------------+------------------------------------------+
//	|					|14127.098		|経度			|dddmm.mmmm (10進)	経度:141.270980
//	|					+---------------+---------------+------------------------------------------+
//	|					|E				|東経西経		|E:東経、W:西経
//	|					+---------------+---------------+------------------------------------------+
//	|					|1				|位置特定品質	|0:位置特定不可
//	|					|				|				|1:SPS（標準測位）
//	|					|				|				|2:DGPS（干渉測位方式）
//	|					+---------------+---------------+------------------------------------------+
//	|					|08				|使用衛星数		|使用衛星数:8個
//	|					+---------------+---------------+------------------------------------------+
//	|					|01.96			|水平精度低下率	|水平精度低下率:1.96
//	|					+---------------+---------------+------------------------------------------+
//	|					|0013			|アンテナの海抜	|アンテナの海抜高さ：13[m]
//	|					+---------------+---------------+------------------------------------------+
//	|					|M				|単位			|[m]メートル
//	|					+---------------+---------------+------------------------------------------+
//	|					|0032			|ジオイド高さ	|ジオイド高さ:32[m]
//	|					+---------------+---------------+------------------------------------------+
//	|					|M				|単位			|[m]メートル
//	|					+---------------+---------------+------------------------------------------+
//	|					|				|DGPSデータの最後の有効なRTCM通信からの時間
//	|					|				|				|空:DGPS不使用
//	|					+---------------+---------------+------------------------------------------+
//	|					|				|差動基準地点ID	|差動基準地点ID:
//	|					+---------------+----------------------------------------------------------+
//	|					|<CR><LF>	文字キャリッジリターン + ラインフィード
//	|					+---------------+----------------------------------------------------------+
//	+-----------------------------------------------------------------------------------------------
//	+-----------------------------------------------------------------------------------------------
//	|	TinyGPSPlusと呼ばれるGPS電文の解析を行ってくれる優れものを利用しています。
//	|	このライブラリで処理可能なGPS(電文)センテンスは、NMEAフォーマットのGNRMC,GNGGAの2つ。
//	|	本ファイルの先頭にフォーマット内容を記載しているのだが、GNRMCとGNGGAそれぞれのセンテンスで、
//	|	取得されるGPS情報の違いを簡単に記載しておきます。
//	|				|GNRMC	|GNGGA	|
//	|	DATE TIME	|	OK	|	OK	|
//	|	Location	|	OK	|	-	|
//	|	Speed		|	OK	|	-	|
//	|	Altitude	|	-	|	OK	|
//	|	Course		|	OK	|	-	|
//	|	Online		|	-	|	OK	|
//	|	CourseTo	|	OK	|	-	|*入力パラメータにLocationが必要な為
//	|	Distance	|	OK	|	-	|*入力パラメータにLocationが必要な為
//	|-----------------------------------------------------------------------------------------------
//--------------------------------------------------------------------------------------------------
//	+-------+-------+-------------------------------------------------------------------------------
//	|1.6.1	|CAS00	|現在の構成情報を不揮発領域（FLASH）に保存します。
//	+-------+-------+-------------------------------------------------------------------------------
//	|	フォーマット:	$PCAS00 * CS<CR><LF>
//	|	例			:	$PCAS00 * 01
//	|					パラメータ <CR><LF>	文字キャリッジリターン + ラインフィード
//	+-------+-------+-------------------------------------------------------------------------------
//	|1.6.2	|CAS01	|シリアル通信のボーレートを設定する
//	+-------+-------+-------------------------------------------------------------------------------
//	|	フォーマット:	$PCAS01,br*CS<CR><LF>
//	|	例			:	$PCAS01,1*1D
//	|	パラメータ	:	+---+-----------+
//	|					| 0	|	 4800bps|
//	|					| 1	|	 9600bps|<-- 初期値
//	|					| 2	|	19200bps|
//	|					| 3	|	38400bps|
//	|					| 4	|	57600bps|
//	|					| 5	|  115200bps|
//	|					+---+-----------+
//	|					CS			16進値チェックサム、$と*の間のすべての文字の排他的論理和（$と*を含まない）
//	|					パラメータ <CR><LF>	文字キャリッジリターン + ラインフィード
//	+-------+-------+-------------------------------------------------------------------------------
//	|1.6.3	|CAS02	|位置更新レートを設定する
//	+-------+-------+-------------------------------------------------------------------------------
//	|	フォーマット:	$PCAS02,fixInt*CS <CR><LF>
//	|	例			:	$PCAS02,1000*2E
//	|	パラメータ	:	+----+----------------------------------------------------------+ 測位更新間隔（単位はms）
//	|					|1000|更新レートは1Hz、出力は1秒あたり1ポジショニングポイント	|<-- 今回の例
//	|					| 500|更新レートは2Hz、出力は1秒あたり2ポジショニングポイント	|
//	|					| 250|更新レートは4Hz、出力は1秒あたり4ポジショニングポイント	|
//	|					| 200|更新レートは5Hz、出力は1秒あたり5ポジショニングポイント	|
//	|					| 100|更新レートは10Hz、出力は1秒あたり10ポジショニングポイント	|
//	|					+----+----------------------------------------------------------+
//	|					CS			16進値チェックサム、$と*の間のすべての文字の排他的論理和（$と*を含まない）
//	|					<CR><LF>	文字キャリッジリターン + ラインフィード
//	+-----------------------------------------------------------------------------------------------
//	|1.6.4	|CAS03	|出力が必要なNMEAセンテンスを設定するか、出力を停止します。
//	+-------+-------+-------------------------------------------------------------------------------
//	|	フォーマット:	$PCAS03,fixInt*CS <CR><LF>
//	|	フォーマット:	$PCAS03,nGGA,nGLL,nGSA,nGSV,nRMC,nVTG,nZDA,nTXT*CS <CR><LF>
//	|	例			:	$PCAS03,1,1,1,1,1,1,0,1*03
//	|	パラメータ	:	+----+----------------------------------------------------------+ 
//	|					|	1|PCBA03文字列メッセージID、ステートメントヘッダー			|
//	|					|	2|nGGA値GGA出力頻度											|*
//	|					|	 |  出力頻度は出力頻度は、位置更新率に基づいています。		|
//	|					|	 |  n（0-9）は、n回ごとに1回出力することを意味し、			|
//	|					|	 |	0 はステートメントは出力されません。					|
//	|					|	 |  空の場合は、元の構成が保持されます。					|
//	|					|	3|nGLL値GLL出力周波数、nGGAと同じ（地理的位置-緯度/経度）	|
//	|					|	4|nGSA値GSA出力周波数、nGGAと同じ（精度DOP計数）			|
//	|					|	5|nGSV値GSV出力周波数、nGGAと同じ（可視衛星）				|
//	|					|	6|nRMC値RMC出力周波数、nGGAと同じ（最小専用ナビゲーション）	|*
//	|					|	7|nVTG値VTG出力周波数、nGGAと同じ（対地速度と機首方向）		|
//	|					|	8|nZDA値ZDA出力周波数、nGGAと同じ（日時）					|
//	|					|	9|nTXT値TXT出力周波数、nGGAと同じ（テキスト送信）			|
//	|					+----+----------------------------------------------------------+
//	|					CS			16進値チェックサム、$と*の間のすべての文字の排他的論理和（$と*を含まない）
//	|					<CR><LF>	文字キャリッジリターン + ラインフィード
//	+-----------------------------------------------------------------------------------------------
//	|1.6.5	|CAS04	|初期化システムとチャンネル数を設定します。
//	+-------+-------+-------------------------------------------------------------------------------
//	|	フォーマット:	$PCAS04,mode*hh<CR><LF>
//	|	例			:	$PCAS04,3*1A
//	|	パラメータ	:	+----+----------------------------------------------------------+ 
//	|					|	 |作業システム構成。										|
//	|					|	1|GPS				:SingleMode - GPS						|
//	|					|	2|BDS				:SingleMode - 北斗						|
//	|					|	3|GPS+BDS			:DualMode   - GPS and 北斗				|
//	|					|	4|GLONASS			:SingleMode - GLONASS					|
//	|					|	5|GPS+GLONASS		:DualMode   - GPS and GLONASS			|
//	|					|	6|BDS+GLONASS		:DualMode   - 北斗 and	GLONASS			|
//	|					|	7|GPS+BDS+GLONASS	:DualMode   - GPS, 北斗, GLONASS		|
//	|					+----+----------------------------------------------------------+
//	|					CS			16進値チェックサム、$と*の間のすべての文字の排他的論理和（$と*を含まない）
//	|					<CR><LF>	文字キャリッジリターン + ラインフィード
//	+-----------------------------------------------------------------------------------------------
//	|1.6.6	|CAS05	|NMEA プロトコル タイプの選択を設定します。
//	+-------+-------+-------------------------------------------------------------------------------
//	|	フォーマット:	$PCAS05,mode*hh<CR><LF>
//	|	例			:	$PCAS05,1*19
//	|	パラメータ	:	+----+----------------------------------------------------------+ 
//	|					|	2|NMEA 4.1以上に対応										|
//	|					|	5|BDS/GPS DualMode, NMEA 2.3 以上と互換性					|
//	|					|	9|Single GPS NMEA0183、NMEA 2.2 と互換性					|
//	|					+----+----------------------------------------------------------+
//	|					CS			16進値チェックサム、$と*の間のすべての文字の排他的論理和（$と*を含まない）
//	|					<CR><LF>	文字キャリッジリターン + ラインフィード
//	+-----------------------------------------------------------------------------------------------
//	CAS06-モジュールのソフトウェアおよびハードウェア情報を照会する
//	CAS10-起動モードと補助情報の構成
//	CAS20-オンラインアップグレード手順
//	+-----------------------------------------------------------------------------------------------
//--------------------------------------------------------------------------------------------------
//--------------------------------------------------------------------------------------------------
// GPSセンサーに対する通信電文を生成する。
//--------------------------------------------------------------------------------------------------
VOID				_MyGPS::SendGPSControlCommand(
String				strCommand)
{
	//----------------------------------------------------------------------------------------------
	// チェックデジットの計算を行う（ASCII2Byteの文字列に変換します）
	//----------------------------------------------------------------------------------------------
	CHAR	cCheckDigit = 0x00;
	for (UINT iIndex =0; iIndex < strCommand.length(); iIndex++) {
		cCheckDigit = cCheckDigit ^ strCommand.charAt(iIndex);
	}
	CHAR	szCheckDigit[4];
	snprintf(szCheckDigit, sizeof(szCheckDigit), "%02X", cCheckDigit);

	//----------------------------------------------------------------------------------------------
	// 通信電文フォーマットの形式に変換する
	//	"$" + [strCommand] + "*" + [CheckDigit:2Byte ASCII] + "\r\n"
	//----------------------------------------------------------------------------------------------
	String	strReturn = "$" + strCommand + "*" + szCheckDigit + "\r\n";

	//----------------------------------------------------------------------------------------------
	// 通信電文フォーマットの形式で呼び出し元に返却する
	//----------------------------------------------------------------------------------------------
#ifdef	MY_DEBUG_GPS_DUMP_DETAIL
	MY_HEXDUMP((VOID *)strReturn.c_str(), strReturn.length(), "SendDump");
#endif
	MYGPS_Serial.print(strReturn);

	//----------------------------------------------------------------------------------------------
	// 優しさタイマ値を設定（センサー側の通信速度変更処理待ち）
	//----------------------------------------------------------------------------------------------
	delay(50);
}
/**/
//--------------------------------------------------------------------------------------------------
// クラス初期メソッド
//--------------------------------------------------------------------------------------------------
_MyGPS::_MyGPS()
{
	this->dtGPSDateTime		= DateTime(2000, 1, 1, 0, 0, 0);
	this->ucGPSCentiSecond	= 0;											// GPS(センチ秒)	
	this->ulReceiveByte		= (ULONG)0;										// センサー受信データバイト数
	this->ulLoopCount		= (ULONG)0;										// センサー情報ループカウンタ
//
	this->MyGPSPoint.dLat	= (DOUBLE)0.0;									// 座標 
	this->MyGPSPoint.dLng	= (DOUBLE)0.0;									//
	this->dGPSSpeed			= (DOUBLE)0.0;									// 移動速度
	this->dGPSCourse		= (DOUBLE)0.0;									// 移動進行方向
//
	this->cGPSOnlineNum		= (CHAR)0;										// GPSオンライン衛星数　 生データはINT
	this->dGPSAltitude		= (DOUBLE)0.0;									// 海抜高度（ｍ）　　　　生データはDOUBLE
}
/**/
//--------------------------------------------------------------------------------------------------
// クラス終了メソッド
//--------------------------------------------------------------------------------------------------
_MyGPS::~_MyGPS()
{
}
/**/
//--------------------------------------------------------------------------------------------------
// GPSデバイスを初期化する
// SerialSpeed : 300, 1200, 2400, 4800, [9600], 14400, 19200, 28800, 38400, 57600, 115200
//--------------------------------------------------------------------------------------------------
_MyTask::_MyTaskRet	_MyGPS::MyBegin(
_MyDevice			*pMyDevice,
_MyJARVis			*pMyJARVis)
{
	//----------------------------------------------------------------------------------------------
	// Serial1 経由で、GPSデバイス・シリアル通信を準備する：(Start 1bit) + 8bit + (Stop 1bit/non parity)
	//----------------------------------------------------------------------------------------------
	MYGPS_Serial.begin(9600);
	while(!MYGPS_Serial)	{
		//------------------------------------------------------------------------------------------
		// GPSデバイスの接続I/FであるSerial1が初期化されるまで処理をループする。
		// ついでに、デバイスマーカーが点滅する様に、、、、。
		//------------------------------------------------------------------------------------------
		delay(500);
		pMyDevice->SetDeviceInfo(_MyDEV_ID::MY_DEVID_GPS, _MyDEV_STAT::MY_DEVSTAT_FAIL);	// MY_DEVSTAT_FAIL
		delay(500);
		pMyDevice->SetDeviceInfo(_MyDEV_ID::MY_DEVID_GPS, _MyDEV_STAT::MY_DEVSTAT_NONE);	// MY_DEVSTAT_NONE
	}
	//----------------------------------------------------------------------------------------------
	// 基底（タスク）管理クラスに、次回の処理「ＳＥＴＵＰ」を返却する
	//----------------------------------------------------------------------------------------------
	return	_MyTask::_MyTaskRet::MY_DEVICE_STATUS_SETUP;
}
/**/
//--------------------------------------------------------------------------------------------------
// ＧＰＳセンサーの情報を更新する（センサーからの受信情報を解析する）
//--------------------------------------------------------------------------------------------------
_MyTask::_MyTaskRet	_MyGPS::MyUpdate(
_MyDevice			*pMyDevice,
_MyJARVis			*pMyJARVis)
{
	//----------------------------------------------------------------------------------------------
	// GPSセンサーデータは、無手順のUART経由で受信します。
	//----------------------------------------------------------------------------------------------
	INT		iAvailableByte = MYGPS_Serial.available();						// 受信バッファのデータ数を保存
	while (iAvailableByte > 0) {											// UART受信バッファにデータが存在する場合
		//------------------------------------------------------------------------------------------
		// UARTからGPS受信データ（1Byte）を取り出して、TinyGPSPlusライブラリに（デコード）渡す
		//------------------------------------------------------------------------------------------
		INT	iReadBuff = MYGPS_Serial.read();								// シリアルから情報(文字）を取得する
		iAvailableByte --;													// 受信バッファのデータ数を減算
#ifdef	MY_DEBUG_GPS_DUMP_DETAIL
		this->MyGPSHexDump(iReadBuff);										// Debug GPS Dump
#endif
		if (this->MyTinyGPS.encode(iReadBuff)) {							// TinyGPSライブラリちゃんに渡してデコード
			//--------------------------------------------------------------------------------------
			// 処理したGPS電文種別毎に、受信情報の処理を行います。
			//--------------------------------------------------------------------------------------
			switch(this->MyTinyGPS.curSentenceType) {
				//----------------------------------------------------------------------------------
				// GGAセンテンス情報を保存する（GGA電文は 1Hz間隔で送出される）
				//----------------------------------------------------------------------------------
				case	TinyGPSPlus::GPS_SENTENCE_GPGGA:
					pMyDevice->MyFDRBodyRecNow.SetGPSGGAData(
								this->GetGPSOnlineNum(),					// GPS オンライン衛星数
								this->GetGPSAltitude());					// GPS 海抜高度
					//---
					//------------------------------------------------------------------------------
					// デバイス管理クラスにタスク状態を通知する
					//------------------------------------------------------------------------------
					if (this->cGPSOnlineNum > 0)	pMyDevice->SetDeviceInfo(_MyDEV_ID::MY_DEVID_GPS, _MyDEV_STAT::MY_DEVSTAT_OPEN);
					else							pMyDevice->SetDeviceInfo(_MyDEV_ID::MY_DEVID_GPS, _MyDEV_STAT::MY_DEVSTAT_LOST);
#ifdef	MY_DEBUG_GPS_DUMP_DETAIL
					MY_LOG("GPS_HEAD : Online=%d / Alt=%f\n", this->cGPSOnlineNum, this->dGPSAltitude);
#endif
					break;

				//----------------------------------------------------------------------------------
				// RMCセンテンス情報を保存する（RMC電文は10Hz間隔で送出される）
				//----------------------------------------------------------------------------------
				case	TinyGPSPlus::GPS_SENTENCE_GPRMC:
					pMyDevice->MyFDRBodyRecNow.SetGPSRMCData(
								this->GetGPSDateTime(),						// GPS 日付(年月日時分秒)
								this->ucGPSCentiSecond,						// GPS センチ秒
								this->GetGPSPosition(),						// GPS ロケーション
								this->GetGPSSpeed(),						// GPS 移動速度(Km/h)
								this->GetGPSCourse());						// GPS 進行方向方位
					//---
					//------------------------------------------------------------------------------
					// FDRRec書き込み用Ringバッファに情報を新規挿入する。
					//------------------------------------------------------------------------------
					pMyDevice->FDRRingBuffPush(/* pMyDevice->MyFDRBodyRecNow */);

					//------------------------------------------------------------------------------
					// 最新GPS情報をJARVisに通知して、現在状態を更新・解析させる
					//------------------------------------------------------------------------------
					pMyJARVis->AnalyzeFDRRec(&pMyDevice->MyFDRBodyRecNow, pMyDevice);
#ifdef	MY_DEBUG_GPS_DUMP_DETAIL
					MY_LOG("GPS_Body : DT=%04d/%02d/%02d %02d:%02d:%02d.%02d / POS=%10.6lf, %10.6lf / SPEED=%lf / COURSE=%lf\n",
										this->dtGPSDateTime.year(), this->dtGPSDateTime.month(),  this->dtGPSDateTime.day(),
										this->dtGPSDateTime.hour(), this->dtGPSDateTime.minute(), this->dtGPSDateTime.second(), this->ucGPSCentiSecond,
										this->MyGPSPoint.dLat, this->MyGPSPoint.dLng,
										this->dGPSSpeed,
										this->dGPSCourse);
#endif
					break;

				//----------------------------------------------------------------------------------
				// RMCセンテンス組み立て中
				//----------------------------------------------------------------------------------
				case	TinyGPSPlus::GPS_SENTENCE_OTHER:
				default:
					break;
			}
		}
//---
		//------------------------------------------------------------------------------------------
		// GPSセンサーから送信されるGPS電文（センテンス）の受信が完了する前に、UART受信バッファを
		// 読み切ってしまう可能性があります。
		// 最大10回（≒10mmSec）のdelay(1)≒タスク切り替えを行うことで、UART受信バッファへのデータ
		// 蓄積を期待します。
		//------------------------------------------------------------------------------------------
		INT		iRetryCount = 0;
		while(! iAvailableByte) {
			//--------------------------------------------------------------------------------------
			// UARTシリアルの受信バッファにデータが蓄積されることを期待してループする。（最大5回）
			//--------------------------------------------------------------------------------------
			delay(1);														// タスク切り替え
			iAvailableByte = MYGPS_Serial.available();						// UART受信済みバッファ数を再取得
			iRetryCount ++;													// リトライカウンタを加算
			if (iRetryCount > 5)		break;
		}
	}	// End Of While
//---
	//----------------------------------------------------------------------------------------------
	//　タイムアウト検知用カウンタを加算
	//----------------------------------------------------------------------------------------------
	this->ulLoopCount ++;													// 内部カウンタを加算

	//----------------------------------------------------------------------------------------------
	// 受信バイト総数に変化があった場合、ＧＰＳ情報に変化があった可能性が高い
	//----------------------------------------------------------------------------------------------
	ULONG	ulCharsProcessed = this->MyTinyGPS.charsProcessed();
	if (ulCharsProcessed > this->ulReceiveByte) {
		//------------------------------------------------------------------------------------------
		// 内部情報を更新
		//------------------------------------------------------------------------------------------
		this->ulLoopCount = (ULONG)0;										// 内部カウンタをリセット
		this->ulReceiveByte = ulCharsProcessed;								// 新しい受信バイト総数をセット
	} else {
		//------------------------------------------------------------------------------------------
		// 受信バイト数が、（１００回以上）変化しない場合は、（センサーとのケーブル切断？）エラーと見なす
		//------------------------------------------------------------------------------------------
		if (this->ulLoopCount > 100) {
			//--------------------------------------------------------------------------------------
			// デバイス管理クラスにタスク状態を通知する(MY_DEVSTAT_FAIL)
			//--------------------------------------------------------------------------------------
			pMyDevice->SetDeviceInfo(_MyDEV_ID::MY_DEVID_GPS, _MyDEV_STAT::MY_DEVSTAT_FAIL);
			//
			//--------------------------------------------------------------------------------------
			// 基底（タスク）管理クラスに長期休暇を返却する
			//--------------------------------------------------------------------------------------
			return	_MyTask::_MyTaskRet::MY_DEVICE_STATUS_LONGSLEEP;
		}
	}
	//----------------------------------------------------------------------------------------------
	// 基底（タスク）管理クラスに正常終了を返却する
	//----------------------------------------------------------------------------------------------
	return	_MyTask::_MyTaskRet::MY_DEVICE_STATUS_OPEN;
}
/**/
//--------------------------------------------------------------------------------------------------
// ＧＰＳセンサーをセットアップする
//--------------------------------------------------------------------------------------------------
_MyTask::_MyTaskRet	_MyGPS::MySetup(
_MyDevice			*pMyDevice,
_MyJARVis			*pMyJARVis)
{
	//----------------------------------------------------------------------------------------------
	// デバイス管理クラスにタスク状態を通知する(MY_FDELOGID_SETUP)
	//----------------------------------------------------------------------------------------------
	pMyDevice->SetDeviceInfo(_MyDEV_ID::MY_DEVID_GPS, _MyDEV_STAT::MY_DEVSTAT_SETUP);
//---
	//----------------------------------------------------------------------------------------------
	// GPSセンサーに対してコマンドを送信して、センサーの動作を変更します。
	//----------------------------------------------------------------------------------------------
	// 以下、接続するGPSセンサー毎に設定が必要と思われる部分です。
	// 今回利用しているGPSセンサーの設定を記載します。
	// シリアル通信 : START 1bit + DATA 8bit + STOP 1bit (Non Parity)  速度 : 9600bps
	// センサーの測位更新頻度 : 10pps(GGA,RMCのみ送信）
	// 構成情報を不揮発領域に保存
	//	 Serial(GROVE)ケーブルが外れた場合、GPSセンサーへの電源供給が遮断され、GPSセンサーが
	//	 初期状態 に移行されます。
	//	 （GPSセンサー内蔵の不揮発領域に保存されている状態に移行されます）
	//	 センサーとの通信はUARTで行われる為、通信速度に対してそこまで神経質になる必要は無いと
	//	 考えていますが、GPSセンサーユニットを丸ごと新品に交換した場合でも、ソフト変更無しに
	//	 処理が継続出来る様に、初回はセンサーデフォルトの通信速度を利用して操作コマンドを送り
	//	 付け、その後、通信速度を上げています。
	//----------------------------------------------------------------------------------------------
//---
	//----------------------------------------------------------------------------------------------
	// 必要最低限の情報だけを送信する様に、センサーに対して通知する（センサーの不揮発情報にセット）　
	//----------------------------------------------------------------------------------------------
	this->SendGPSControlCommand(F("PCAS01,1"));								// Serial速度を9600bpsに変更
//	this->SendGPSControlCommand(F("PCAS04,3"));								// 測位利用衛星システムをGPS,BDSに変更
//	this->SendGPSControlCommand(F("PCAS04,7"));								// 測位利用衛星システムをGPS,BDS,GLONASSに変更
	this->SendGPSControlCommand(F("PCAS04,1"));								// 測位利用衛星システムをGPS(Single)に変更
	this->SendGPSControlCommand(F("PCAS05,2"));								// プロトコル タイプの選択を設定
	this->SendGPSControlCommand(F("PCAS02,100"));							// 測位更新頻度を10ppsに変更
	this->SendGPSControlCommand(F("PCAS03,9,0,0,0,1,0,0,0"));				// 出力が必要なNMEA(GGA,RMC)を設定
	this->SendGPSControlCommand(F("PCAS00"));								// 構成情報を不揮発領域（FLASH）に保存
	delay(100);																// 
//---
#ifdef	MY_GPS_SERIAL_HISPEEDMODE
	//----------------------------------------------------------------------------------------------
	// 通信速度を19200bpsに変更する（電源再投入時は揮発する）
	//----------------------------------------------------------------------------------------------
	this->SendGPSControlCommand(F("PCAS01,2"));								// Serial速度を19200bpsに変更
//---
	//----------------------------------------------------------------------------------------------
	// 優しさタイマ値を設定（センサー側の通信速度変更処理待ち）後に、本体UART速度を変更する
	//----------------------------------------------------------------------------------------------
	delay(100);																// 
	MYGPS_Serial.end();				delay(100);								// 優しさタイマ(100m)
	MYGPS_Serial.begin(19200);		delay(100);								// 優しさタイマ(100m)
#endif
//--
	//----------------------------------------------------------------------------------------------
	// デバイス管理クラスにタスク状態を通知する(MY_DEVSTAT_OPEN)
	//----------------------------------------------------------------------------------------------
	pMyDevice->SetDeviceInfo(_MyDEV_ID::MY_DEVID_GPS, _MyDEV_STAT::MY_DEVSTAT_OPEN);

	//----------------------------------------------------------------------------------------------
	// 基底（タスク）管理クラスに正常終了を返却する
	//----------------------------------------------------------------------------------------------
	return	_MyTask::_MyTaskRet::MY_DEVICE_STATUS_OPEN;
}
/**/
//--------------------------------------------------------------------------------------------------
// GPSデバイスから「日時」情報を取得する
// GPSデバイスから取得される日時情報はUTCの為、LOCALTIMEに変換して保存する
//--------------------------------------------------------------------------------------------------
DateTime			_MyGPS::GetGPSDateTime(SHORT sTimeShift)
{
#ifdef	MY_DEBUG_GPSDATETIME
	MY_PRIVATE	DateTime	dtTemp(F(__DATE__), F(__TIME__));
	ULONG	ulTime = millis();
	this->dtGPSDateTime		= DateTime(dtTemp.secondstime() + (ulTime/1000));
	this->ucGPSCentiSecond++;
	if (this->ucGPSCentiSecond > 9)	this->ucGPSCentiSecond = 0;
	return	this->dtGPSDateTime;
#endif
	if ((this->MyTinyGPS.date.isValid())&&(this->MyTinyGPS.time.isValid())) {
		//------------------------------------------------------------------------------------------
		// 簡易初期化チェックを行う
		//------------------------------------------------------------------------------------------
		USHORT	usYear = this->MyTinyGPS.date.year();
		if (usYear > 2000) {
			//--------------------------------------------------------------------------------------
			// GPS情報から取得した(UTC)日時時刻情報をLocalTimeに変換して退避する
			//--------------------------------------------------------------------------------------
			DateTime	dtTemp(
							this->MyTinyGPS.date.year(),
							this->MyTinyGPS.date.month(),
							this->MyTinyGPS.date.day(),
							this->MyTinyGPS.time.hour(),
							this->MyTinyGPS.time.minute(),
							this->MyTinyGPS.time.second());
			this->dtGPSDateTime		= dtTemp - TimeSpan(0, sTimeShift, 0, 0);
			this->ucGPSCentiSecond	= this->MyTinyGPS.time.centisecond();
		}
	}
	//----------------------------------------------------------------------------------------------
	// 最新のGPSを通知する
	//----------------------------------------------------------------------------------------------
	return	this->dtGPSDateTime;
}
/**/
//--------------------------------------------------------------------------------------------------
// GPSデバイスから「経緯度・高度」情報を取得する
// MyGPSPoint :
// 	緯度（latitude）	赤道から南と北
// 	経度（longitude）	グリニッジ天文台跡を通る子午線（赤道に直交する南北線を基準）で東西
//--------------------------------------------------------------------------------------------------
_MyGPSPoint			_MyGPS::GetGPSPosition(VOID)
{
#ifdef	MY_DEBUG_GPSPOSISION
MY_PRIVATE	DOUBLE	d = (DOUBLE)0.00001;
	if ((!this->MyGPSPoint.dLat)&&(!this->MyGPSPoint.dLng)) {
		this->MyGPSPoint.dLat = 35.6405704;										// 指定GPS座標（緯度経度）
		this->MyGPSPoint.dLng = 139.3417181;									//
	}
	this->MyGPSPoint.dLat	+= d;				//	this->MyGPSPoint.dLat	+= 0.0000001;
	this->MyGPSPoint.dLng	+= d;
	return	this->MyGPSPoint;
#endif
	if (this->MyTinyGPS.location.isValid()) {
		if (this->MyTinyGPS.location.isUpdated()) {
			this->MyGPSPoint.dLat = this->MyTinyGPS.location.lat();
			this->MyGPSPoint.dLng = this->MyTinyGPS.location.lng();
		}
	}
	//----------------------------------------------------------------------------------------------
	// データをセットして終了する（座標が取得出来なかった場合は、過去座標を返す）
	//----------------------------------------------------------------------------------------------
	return	this->MyGPSPoint;
}
/**/
//--------------------------------------------------------------------------------------------------
// GPSデバイスから「移動速度(時速)」情報を取得する
//--------------------------------------------------------------------------------------------------
DOUBLE				_MyGPS::GetGPSSpeed(VOID)
{
#ifdef	MY_DEBUG_GPSSPEED
	MY_PRIVATE	INT		iType = 0;
	switch(iType) {
		case	0:	this->dGPSSpeed += 0.2;	if (this->dGPSSpeed >= 120) {	this->dGPSSpeed = 120.0;	iType = 1; }	break;
		case	1:	this->dGPSSpeed -= 0.4;	if (this->dGPSSpeed <=	 0)	 {	this->dGPSSpeed = 0.0;		iType = 2; }	break;
		case	2:
		default:	iType += 1;	if (iType >= 1000) { iType = 0; }														break;
	}
	return	this->dGPSSpeed;
#endif
	if (this->MyTinyGPS.speed.isValid()) {
		if (this->MyTinyGPS.speed.isUpdated()) {
			this->dGPSSpeed = this->MyTinyGPS.speed.kmph();
		}
	}
	//----------------------------------------------------------------------------------------------
	// GPSから情報が取得出来なかった時は、データは初期値を返す
	//----------------------------------------------------------------------------------------------
	return	this->dGPSSpeed;
}
/**/
//--------------------------------------------------------------------------------------------------
// GPSデバイスから「高度（海抜）」情報を取得する					＃桁落ち必須！！
//--------------------------------------------------------------------------------------------------
DOUBLE				_MyGPS::GetGPSAltitude(VOID)
{
#ifdef	MY_DEBUG_GPSALTITUDE
	MY_PRIVATE	DOUBLE			dLocalAltidtude = 0.0;
	MY_PRIVATE	DOUBLE			dLocalAddNum = 0.2;
	if (dLocalAltidtude > 3000)		dLocalAddNum = -1.0;
	if (dLocalAltidtude < 10)		dLocalAddNum = +0.2;
	dLocalAltidtude += dLocalAddNum;
	return	dLocalAltidtude;
#endif
	if (this->MyTinyGPS.altitude.isValid()) {
		if (this->MyTinyGPS.altitude.isUpdated()) {
			this->dGPSAltitude = this->MyTinyGPS.altitude.meters();
		}
	}
	return	this->dGPSAltitude;
}
/**/
//--------------------------------------------------------------------------------------------------
// GPSデバイスから「進行コース（方位）」情報を取得します。（DOUBLEの精度は必要無いので桁落ちさせます）
// GPS座標aから、A,B,C,Dに移動した時に得られる値を下記に記載します。
// ちなみに、2点のGPS座標に対して距離と方位を求めた場合、出発地(a)、目的地(N,E,S,W)と同じ
//							
//					+N						+-------+-------+
//					|						|a -> N	|	0	|
//					|						|a -> E	|	90	|
//		W			|			E			|a -> S	|	180	|
//		|-----------+-----------|			|a -> W	|	270	|
//					|a						+-------+-------+
//					|
//					|
//					+S
//
//--------------------------------------------------------------------------------------------------
DOUBLE				_MyGPS::GetGPSCourse(VOID)
{
#ifdef	MY_DEBUG_GPSCOURSE
	MY_PRIVATE	DOUBLE			dLocalCourse = 0.0;
	dLocalCourse += 1.0;
	if (dLocalCourse > 360.0)	dLocalCourse = 0.0;
	return	dLocalCourse;
#endif
	if (this->MyTinyGPS.course.isValid()) {
		if (this->MyTinyGPS.course.isUpdated()) {
			this->dGPSCourse = this->MyTinyGPS.course.deg();
		}
	}
	//----------------------------------------------------------------------------------------------
	// 最新のGPS情報を返す
	//----------------------------------------------------------------------------------------------
	return	this->dGPSCourse;
}
/**/
//--------------------------------------------------------------------------------------------------
// 【オンライン衛星数】情報を取得する（GPSのオンライン衛星数が128を超えたら問題かも）
//--------------------------------------------------------------------------------------------------
CHAR				_MyGPS::GetGPSOnlineNum(VOID)
{
#ifdef	MY_DEBUG_GPSONLINE
	MY_PRIVATE	CHAR			cLocalOnline = 0.0;
	MY_PRIVATE	CHAR			cLocalAddNum = 1;
	if (cLocalOnline > 63)		cLocalAddNum = -1;
	if (cLocalOnline < -20)		cLocalAddNum = +1;
	cLocalOnline += cLocalAddNum;
	this->cGPSOnlineNum = cLocalOnline;

cLocalOnline = this->cGPSOnlineNum = 1;

	return	cLocalOnline;
#endif
	if (this->MyTinyGPS.satellites.isValid()) {
		if (this->MyTinyGPS.satellites.isUpdated()) {
			this->cGPSOnlineNum = this->MyTinyGPS.satellites.value();
		}
	} else {
		this->cGPSOnlineNum = (CHAR)0;
	}
	return	this->cGPSOnlineNum;
}
/**/
//--------------------------------------------------------------------------------------------------
// ＧＰＳ現在座標と指定された座標との距離を取得
//--------------------------------------------------------------------------------------------------
DOUBLE				_MyGPS::GetGPSDistance(_MyGPSPoint	MyGPSPointTo)
{
	//----------------------------------------------------------------------------------------------
	// 現在ＧＰＳ座標尾から指定ＧＰＳ座標までの距離（ｍ単位に変換）を取得
	//----------------------------------------------------------------------------------------------
	return	this->MyTinyGPS.distanceBetween(
							this->MyGPSPoint.dLat,	this->MyGPSPoint.dLng,		// 現在ＧＰＳ座標
							MyGPSPointTo.dLat, 		MyGPSPointTo.dLng);			// 指定されたＧＰＳ座標 
}
/**/
//--------------------------------------------------------------------------------------------------
// ＧＰＳ現在座標と指定された座標との方向を取得
//					Point(A)												Return	: Arrow
//						|								Point - Point(A) : 0		:	North 北
//	Point(D)	------Point-----	Point(B)			Point - Point(B) : 90		:	East  東
//						|								Point - Point(C) : 180		:	South 南
//					Point(C)							Point - Point(D) : 270		:	West  西
//--------------------------------------------------------------------------------------------------
DOUBLE				_MyGPS::GetGPSCourseTo(_MyGPSPoint	MyGPSPointTo)
{
	//----------------------------------------------------------------------------------------------
	// 現在ＧＰＳ座標から指定ＧＰＳ座標への方向を取得
	//----------------------------------------------------------------------------------------------
	return	this->MyTinyGPS.courseTo(
							this->MyGPSPoint.dLat,	this->MyGPSPoint.dLng,		// 現在ＧＰＳ座標
							MyGPSPointTo.dLat,		MyGPSPointTo.dLng);			// 任意のＧＰＳ座標 
}
/**/
//--------------------------------------------------------------------------------------------------
// ＧＰＳセンサーの状態を出力する
//--------------------------------------------------------------------------------------------------
#ifdef	MY_DEBUG_PRINT
VOID				_MyGPS::MyDump(VOID)
{
	MY_TRACE("--- GPS Task Dump Start ---");
	this->MyDumpBase();
	MY_LOG("OnlineNum: %d\n", this->GetGPSOnlineNum());
	MY_LOG("DateTime : %04d/%02d/%02d %02d:%02d:%02d\n",
								this->dtGPSDateTime.year(),	this->dtGPSDateTime.month(),	this->dtGPSDateTime.day(),
								this->dtGPSDateTime.hour(),	this->dtGPSDateTime.minute(),	this->dtGPSDateTime.second());
	MY_LOG("Location : %9.6lf / %9.6lf\n", this->MyGPSPoint.dLat, this->MyGPSPoint.dLng); 
	MY_LOG("Speed    : %6.2lf\n", this->dGPSSpeed);
	MY_LOG("Course   : %6.2lf\n", this->dGPSCourse);
	MY_LOG("Altitude : %9.6lf\n", this->dGPSAltitude); 
	MY_LOG("--- GPS Task Dump End ---");
}
#endif
/**/
//--------------------------------------------------------------------------------------------------
// ＧＰＳセンサーのROWダンプを出力する
//--------------------------------------------------------------------------------------------------
#ifdef	MY_DEBUG_GPS_DUMP_DETAIL
static int ii = 0;
static char szBuff[128];
VOID				_MyGPS::MyGPSHexDump(INT iReadBuff)
{
	if((iReadBuff == 0x0a)||(iReadBuff == 0x0d)||(iReadBuff == '$')){
		if (ii != 0){
			MY_LOG("GPS ROW DATA [%s]\n", szBuff);
		}
		ii = 0;
		::memset(szBuff, 0x00, sizeof(szBuff));
		if (iReadBuff == '$') {
			szBuff[ii] = iReadBuff;
			ii = ii + 1;
		}
	} else {
		szBuff[ii] = iReadBuff;
		ii = ii + 1;
	}
}
#endif
/*-- End Of File --*/
