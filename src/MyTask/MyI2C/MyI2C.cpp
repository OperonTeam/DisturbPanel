//--------------------------------------------------------------------------------------------------
//  Project : Disturbing Information
//  Edition : WioTerminal with Extend multi LCD-Monitor
//  File path : src/MyTask/MyI2C/MyI2C.cpp
//  Copyright 2019, 2020, 2021, 2022, 2023 - OperonTeam
//--------------------------------------------------------------------------------------------------
#include "MyBase.h"
#include "MyDevice.h"
#include "MyJARVis.h"

//--------------------------------------------------------------------------------------------------
// クラス初期メソッド
//--------------------------------------------------------------------------------------------------
_MyI2C::_MyI2C()
{
}
/**/
//--------------------------------------------------------------------------------------------------
// クラス終了メソッド
//--------------------------------------------------------------------------------------------------
_MyI2C::~_MyI2C()
{
}
/**/
//--------------------------------------------------------------------------------------------------
// I2C I/Fに接続したセンサーデバイスを初期化する（＆センサーデータのオフセット値を取得する）
//--------------------------------------------------------------------------------------------------
_MyTask::_MyTaskRet	_MyI2C::MyBegin(
_MyDevice			*pMyDevice,
_MyJARVis			*pMyJARVis)
{
	//----------------------------------------------------------------------------------------------
	// 本体側接続ピン（TwoWire)を初期化する
	//----------------------------------------------------------------------------------------------
	Wire.begin();		delay(100);
	Wire1.begin();		delay(100);
//---
	//----------------------------------------------------------------------------------------------
	// Wire(5v系)
	//	MyPAJ7620.Begin		:	ジェスチャーセンサー（外部）デバイスの初期化を行う
	//----------------------------------------------------------------------------------------------
	this->MyPAJ7620.Begin(_MyDEV_ID::MY_DEVID_PAJ, MYI2C_PAJ7620_ADDRESS, &Wire, pMyDevice);
//---
	//----------------------------------------------------------------------------------------------
	// Wire1(3.3v系)
	//	MyBME280.Begin		:	気象センサー（外部）デバイスの初期化を行う
	//	MyAMG8833.Begin		:	サーモセンサー（外部）デバイスの初期化を行う
	//	MyMPU9250.Begin		:	IMUセンサー（外部）デバイスの初期化を行う（一番最後に初期化する必要がある！）
	//----------------------------------------------------------------------------------------------
	this->cRunType = 0;									// 実行種別をセット
	this->MyBME280.Begin(_MyDEV_ID::MY_DEVID_BME, MYI2C_BME280_ADDRESS, &Wire1, pMyDevice);
	this->MyAMG8833.Begin(_MyDEV_ID::MY_DEVID_AMG, MYI2C_AMG8833_ADDRESS, &Wire1, pMyDevice);
	this->MyMPU9250.Begin(_MyDEV_ID::MY_DEVID_IMU, MYI2C_MPU9250_ADDRESS, &Wire1, pMyDevice);

	//----------------------------------------------------------------------------------------------
	// タスク状態を通知する
	//----------------------------------------------------------------------------------------------
	return	_MyTask::_MyTaskRet::MY_DEVICE_STATUS_OPEN;
}
/**/
//--------------------------------------------------------------------------------------------------
// I2C I/Fに接続したセンサーデバイスから情報を取得する
//--------------------------------------------------------------------------------------------------
_MyTask::_MyTaskRet	_MyI2C::MyUpdate(
_MyDevice			*pMyDevice,
_MyJARVis			*pMyJARVis)
{
	//----------------------------------------------------------------------------------------------
	// IMUセンサーを更新して、最新情報をJARVis(FDRRec)に退避する
	//----------------------------------------------------------------------------------------------
	this->MyMPU9250.Update(pMyDevice);									// IMUセンサー・情報を取得する

	//----------------------------------------------------------------------------------------------
	// １秒間に３回程度の緩い間隔でセンサー情報を順次更新する（≒333mmSec)
	//	・AMG8833: Thermoセンサー
	//	・BME280 : Weatherセンサー
	//	・PAJ7620: Jestureセンサー
	//----------------------------------------------------------------------------------------------
	if (this->IsUserAlert(MY_TASK_USERALERT_WAIT_1SEC / 3)) {
		//------------------------------------------------------------------------------------------
		// タイマを初期化（リセット）する
		//------------------------------------------------------------------------------------------
		this->InitUserAlert();											// ユーザータイマー処理をリセットする

		//------------------------------------------------------------------------------------------
		// 緩やかな感じでセンサーデータを取得する。
		//------------------------------------------------------------------------------------------
		switch(this->cRunType) {
			case	0:	this->MyAMG8833.Update(pMyDevice);	break;		// Thermoセンサー・情報を取得する
			case	1:	this->MyBME280.Update(pMyDevice);	break;		// Weatherセンサー・情報を取得する
			case	2:	this->MyPAJ7620.Update(pMyDevice);	break;		// Jestureセンサー・情報を取得する
		}
		this->cRunType++;
		if (this->cRunType > 2)		this->cRunType = 0;
	}

	//----------------------------------------------------------------------------------------------
	// タスク状態を保存する
	//----------------------------------------------------------------------------------------------
	return	_MyTask::_MyTaskRet::MY_DEVICE_STATUS_OPEN;
}
/**/
//--------------------------------------------------------------------------------------------------
// I2C I/Fに接続したセンサーデバイスのセットアップを行う
//--------------------------------------------------------------------------------------------------
_MyTask::_MyTaskRet	_MyI2C::MySetup(
_MyDevice			*pMyDevice,
_MyJARVis			*pMyJARVis)
{
	//----------------------------------------------------------------------------------------------
	// 全ての取り扱いセンサーに対してセットアップを行う
	//----------------------------------------------------------------------------------------------
	pMyDevice->SetDeviceInfo(_MyDEV_ID::MY_DEVID_IMU, _MyDEV_STAT::MY_DEVSTAT_SETUP);		// ＩＭＵ
	pMyDevice->SetDeviceInfo(_MyDEV_ID::MY_DEVID_BME, _MyDEV_STAT::MY_DEVSTAT_SETUP);		// ＢＭＥ
	pMyDevice->SetDeviceInfo(_MyDEV_ID::MY_DEVID_AMG, _MyDEV_STAT::MY_DEVSTAT_SETUP);		// ＡＭＧ
	pMyDevice->SetDeviceInfo(_MyDEV_ID::MY_DEVID_PAJ, _MyDEV_STAT::MY_DEVSTAT_SETUP);		// ＰＡＪ
//---
	//----------------------------------------------------------------------------------------------
	// 基底（タスク）管理クラスに正常終了を返却する
	//----------------------------------------------------------------------------------------------
	return	_MyTask::_MyTaskRet::MY_DEVICE_STATUS_OPEN;
}
/**/
#ifdef	MY_DEBUG_PRINT
//--------------------------------------------------------------------------------------------------
// 開発用のデータダンプ
//--------------------------------------------------------------------------------------------------
VOID					_MyI2C::MyDump(VOID)
{
	MY_TRACE("Start");
	this->MyDumpBase();
	MY_TRACE("Exit");
}
#endif
/*-- End Of File --*/
