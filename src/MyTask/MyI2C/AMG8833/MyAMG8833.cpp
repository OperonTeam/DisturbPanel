//--------------------------------------------------------------------------------------------------
//  Project : Disturbing Information
//  Edition : WioTerminal with Extend multi LCD-Monitor
//  File path : src/MyTask/MyI2C/AMG8833/MyAMG8833.cpp
//  Copyright 2019, 2020, 2021, 2022, 2023 - OperonTeam
//--------------------------------------------------------------------------------------------------
#include "MyBase.h"
#include "MyDevice.h"

//--------------------------------------------------------------------------------------------------
// クラス初期メソッド
//--------------------------------------------------------------------------------------------------
_MyAMG8833::_MyAMG8833()
{
}
/**/
//--------------------------------------------------------------------------------------------------
// クラス終了メソッド
//--------------------------------------------------------------------------------------------------
_MyAMG8833::~_MyAMG8833()
{
}
/**/
//--------------------------------------------------------------------------------------------------
// センサーを初期化する
//--------------------------------------------------------------------------------------------------
VOID			_MyAMG8833::Begin(
_MyDEV_ID		MyDevID,
UCHAR			ucAddress,
TwoWire			*pTwoWire,
_MyDevice		*pMyDevice)
{
	//----------------------------------------------------------------------------------------------
	// センサー情報更新基底処理：初期処理を行う
	//----------------------------------------------------------------------------------------------
	this->BeginBaseInit(MyDevID, ucAddress, pTwoWire);

	//----------------------------------------------------------------------------------------------
	// デバイス管理クラスにタスク状態を通知する(MY_DEVSTAT_NONE)
	//----------------------------------------------------------------------------------------------
	pMyDevice->SetDeviceInfo(this->MyDevIdI2C, _MyDEV_STAT::MY_DEVSTAT_NONE);
}
/**/
//--------------------------------------------------------------------------------------------------
// センサー情報を更新する
//--------------------------------------------------------------------------------------------------
VOID			_MyAMG8833::Update(
_MyDevice		*pMyDevice)
{
	//----------------------------------------------------------------------------------------------
	// センサー情報更新基底処理：事前処理を行う
	//----------------------------------------------------------------------------------------------
	this->UpdateBaseStart();

	//----------------------------------------------------------------------------------------------
	// センサーの現在状態を取得し、【センサー状態】に応じた処理を行う
	//----------------------------------------------------------------------------------------------
	switch(pMyDevice->GetDeviceInfo(this->MyDevIdI2C)) {
		case	_MyDEV_STAT::MY_DEVSTAT_NONE:									// デバイス未接続
			this->MySensorBegin(pMyDevice);
			break;
		case	_MyDEV_STAT::MY_DEVSTAT_OPEN:									// デバイス接続済み
			this->MySensorUpdate(pMyDevice);
			break;
		case	_MyDEV_STAT::MY_DEVSTAT_SETUP:									// セットアップ
			this->MySensorSetup(pMyDevice);
			break;
		case	_MyDEV_STAT::MY_DEVSTAT_FAIL:									// 接続異常
		case	_MyDEV_STAT::MY_DEVSTAT_LOST:									// データ欠落
		default:
			break;
	}

	//----------------------------------------------------------------------------------------------
	// センサー情報更新基底処理：事後処理を行う
	//----------------------------------------------------------------------------------------------
	this->UpdateBaseExit();
}
/**/
//--------------------------------------------------------------------------------------------------
// センサー関係の処理
//	MySensorBegin					センサーを初期化する
//	MySensorUpdate					センサーを更新（情報取得）する
//	MySensorSetup					センサーをセットアップする
//--------------------------------------------------------------------------------------------------
VOID			_MyAMG8833::MySensorBegin(
_MyDevice		*pMyDevice)
{
	if (MyGlobalTool.MyConfigFile.bAMG_Module) {
		//------------------------------------------------------------------------------------------
		// センサー・実体を初期化する
		//------------------------------------------------------------------------------------------
		if (this->MySensor.begin(this->ucI2CAddress, this->pI2CTwoWire) == true) {
			//--------------------------------------------------------------------------------------
			// デバイス管理クラスにタスク状態を通知する(MY_DEVSTAT_OPEN)
			//--------------------------------------------------------------------------------------
			pMyDevice->SetDeviceInfo(this->MyDevIdI2C, _MyDEV_STAT::MY_DEVSTAT_OPEN);
		}
	} else {
		//------------------------------------------------------------------------------------------
		// デバイス管理クラスにタスク状態を通知する(MY_FDELOGID_OPEN)
		//------------------------------------------------------------------------------------------
		pMyDevice->SetDeviceInfo(this->MyDevIdI2C, _MyDEV_STAT::MY_DEVSTAT_OPEN);
	}
}
/**/
VOID			_MyAMG8833::MySensorUpdate(
_MyDevice		*pMyDevice)
{
	if (MyGlobalTool.MyConfigFile.bAMG_Module) {
		//------------------------------------------------------------------------------------------
		// センサー・実体の情報を更新して、最新情報を退避領域に保存する
		//------------------------------------------------------------------------------------------
		this->MySensor.readPixels(this->fRawBuff);

		//------------------------------------------------------------------------------------------
		// Thrmoイメージ描画用に、取得したThermo情報の分解能を向上させる
		//------------------------------------------------------------------------------------------
		FLOAT	fThermoAve = pMyDevice->MyThermoMatrix.MakeExtendMatrixMap(this->fRawBuff, MyGlobalTool.MyConfigFile.bAMG_Face);

		//------------------------------------------------------------------------------------------
		// センサーで取得したマトリクス情報の全領域平均温度を記録する
		//------------------------------------------------------------------------------------------
		pMyDevice->MyFDRBodyRecNow.SetVehicieDataTempAve(fThermoAve);
	} else {
		//------------------------------------------------------------------------------------------
		// テスト用ダミーデータを設定する
		//------------------------------------------------------------------------------------------
		//
		// サーモ描画領域で、パラパラ・漫画っぽい感じか？
		//
	}
}
/**/
VOID			_MyAMG8833::MySensorSetup(
_MyDevice		*pMyDevice)
{
	//----------------------------------------------------------------------------------------------
	// デバイス管理クラスにタスク状態を通知する(MY_FDELOGID_SETUP)
	//----------------------------------------------------------------------------------------------
	pMyDevice->SetDeviceInfo(this->MyDevIdI2C, _MyDEV_STAT::MY_DEVSTAT_SETUP);
//---
	delay(500);
//---
	//----------------------------------------------------------------------------------------------
	// デバイス管理クラスにタスク状態を通知する(MY_DEVSTAT_OPEN)
	//----------------------------------------------------------------------------------------------
	pMyDevice->SetDeviceInfo(this->MyDevIdI2C, _MyDEV_STAT::MY_DEVSTAT_OPEN);
}
/*-- End Of File --*/
