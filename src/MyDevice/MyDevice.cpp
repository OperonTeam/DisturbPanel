//--------------------------------------------------------------------------------------------------
//  Project : Disturbing Information
//  Edition : WioTerminal with Extend multi LCD-Monitor
//  File path : src/MyDevice/MyDevice.cpp
//  Copyright 2019, 2020, 2021, 2022, 2023 - OperonTeam
//--------------------------------------------------------------------------------------------------
#include "MyBase.h"
#include "MyDevice.h"
#include "MyJARVis.h"
#include "Boot/MyBootsplash.h"

//--------------------------------------------------------------------------------------------------
// クラス初期メソッド：この手の処理をコンストラクタ内で実行するのは嫌なのですが、、、。
//--------------------------------------------------------------------------------------------------
_MyDevice::_MyDevice()
{
	//----------------------------------------------------------------------------------------------
	// デバイス・センサー状態を初期化する
	//----------------------------------------------------------------------------------------------
	this->SetDeviceInfo(_MyDEV_ID::MY_DEVID_GPS, _MyDEV_STAT::MY_DEVSTAT_NONE);			// ＧＰＳ
	this->SetDeviceInfo(_MyDEV_ID::MY_DEVID_RTC, _MyDEV_STAT::MY_DEVSTAT_NONE);			// ＲＴＣ
	this->SetDeviceInfo(_MyDEV_ID::MY_DEVID_NET, _MyDEV_STAT::MY_DEVSTAT_NONE);			// ＮＥＴ
	this->SetDeviceInfo(_MyDEV_ID::MY_DEVID_FDR, _MyDEV_STAT::MY_DEVSTAT_NONE);			// ＦＤＲ
	this->SetDeviceInfo(_MyDEV_ID::MY_DEVID_IMU, _MyDEV_STAT::MY_DEVSTAT_NONE);			// ＩＭＵ
	this->SetDeviceInfo(_MyDEV_ID::MY_DEVID_BME, _MyDEV_STAT::MY_DEVSTAT_NONE);			// ＢＭＥ
	this->SetDeviceInfo(_MyDEV_ID::MY_DEVID_AMG, _MyDEV_STAT::MY_DEVSTAT_NONE);			// ＡＭＧ
	this->SetDeviceInfo(_MyDEV_ID::MY_DEVID_PAJ, _MyDEV_STAT::MY_DEVSTAT_NONE);			// ＰＡＪ
	this->SetDeviceInfo(_MyDEV_ID::MY_DEVID_HAL, _MyDEV_STAT::MY_DEVSTAT_NONE);			// ＨＡＬ
//---
	//----------------------------------------------------------------------------------------------
	// Ringバッファをクリアする
	//----------------------------------------------------------------------------------------------
	this->ulRecordSeq				= (ULONG)0;							// FDRRecレコードシーケンス番号
	this->iUnConfirmedNum			= 0;								// SD書込み未完了レコード件数
	this->MyFDRRingBuff.clear();
//---
}
/**/
_MyDevice::~_MyDevice()
{
}
/**/
//--------------------------------------------------------------------------------------------------
// デバイスステータス・管理メソッド
//	RTCAdjust						: RTC日時調整メソッド
//	GPSCourseTo						: 指定座標までのコース
//	GPSDistance						: 指定座標までの距離
//	TaskCreateStart					: 全タスク生成・開始メソッド
//	SetButtonInfo					: 手動操作情報の設定
//	GetButtonInfo					: 手動操作情報の取得
//--------------------------------------------------------------------------------------------------
//--------------------------------------------------------------------------------------------------
// RTC日時調整メソッド
//--------------------------------------------------------------------------------------------------
VOID			_MyDevice::RTCAdjust(DateTime dtAdjust)
{
	this->MyRTCDevice.adjust(dtAdjust);
}
/**/
//--------------------------------------------------------------------------------------------------
//	GPSCourseTo						: 指定座標までのコース
//--------------------------------------------------------------------------------------------------
FLOAT			_MyDevice::GPSCourseTo(_MyGPSPoint MyGPSPoint)
{
	return	this->MyGPS.GetGPSCourseTo(MyGPSPoint);
}
/**/
//--------------------------------------------------------------------------------------------------
//	GPSDistance						: 指定座標までの距離
//--------------------------------------------------------------------------------------------------
FLOAT			_MyDevice::GPSDistance(_MyGPSPoint MyGPSPoint)
{
	return	this->MyGPS.GetGPSDistance(MyGPSPoint);
}
/**/
//--------------------------------------------------------------------------------------------------
// 全タスク生成・開始メソッド
//--------------------------------------------------------------------------------------------------
VOID			_MyDevice::Initialize(_MyJARVis *pMyJARVis)
{
	//----------------------------------------------------------------------------------------------
	// 内臓の十字ボタンセンサーを初期化する。
	//----------------------------------------------------------------------------------------------
	this->MyButton.SetInterrupt();

	//----------------------------------------------------------------------------------------------
	// 内蔵RTCを初期化する。（内蔵RTCのライブラリは、TRUE以外の戻り値を返さない。2022/11/01）
	// RTC初期化後はGPSの時刻補正待ちに遷移する。（WioTerminal内蔵RTCは時刻バックアップが無い）
	//----------------------------------------------------------------------------------------------
	this->MyRTCDevice.begin();
	this->SetDeviceInfo(_MyDEV_ID::MY_DEVID_RTC, _MyDEV_STAT::MY_DEVSTAT_SETUP);

	//----------------------------------------------------------------------------------------------
	// ＦＤＲ領域の確保・初期化
	//----------------------------------------------------------------------------------------------
	this->FDRRingBuffInit();													// RingBuffの初期化

	//----------------------------------------------------------------------------------------------
	// ＪＡＲＶｉｓクラスの初期化
	//----------------------------------------------------------------------------------------------
	pMyJARVis->Initialize(this);												// JARVis分析クラス
}
/**/
//--------------------------------------------------------------------------------------------------
// 手動操作情報の設定
//--------------------------------------------------------------------------------------------------
VOID			_MyDevice::SetButtonInfo(UINT uiGesture)
{
	//----------------------------------------------------------------------------------------------
	// MyButtonクラスをPrivate空間に置いてあるからなんだけどね。。。。　
	//----------------------------------------------------------------------------------------------
	this->MyButton.SetManualOperationInfo(uiGesture);
}
/**/
//--------------------------------------------------------------------------------------------------
// 手動操作情報の取得
//--------------------------------------------------------------------------------------------------
UINT			_MyDevice::GetButtonInfo(UINT uiMaskInfo)
{
	//----------------------------------------------------------------------------------------------
	// MyButtonクラスをPrivate空間に置いてあるからなんだけどね。。。。　
	//----------------------------------------------------------------------------------------------
	return	this->MyButton.GetManualOperationInfo(uiMaskInfo);
}
/*
*/
/**/
//--------------------------------------------------------------------------------------------------
// デバイスステータス・管理メソッド
//	SetDeviceInfo					:　デバイス状態を設定します。
//	GetDeviceInfo					:　デバイス状態を取得します。
//	IsAllDeviceNormal				:  全ての管理デバイスが正常か？
//--------------------------------------------------------------------------------------------------
/**/
//--------------------------------------------------------------------------------------------------
// デバイス状態を設定します。
//--------------------------------------------------------------------------------------------------
VOID			_MyDevice::SetDeviceInfo(_MyDEV_ID MyDevID, _MyDEV_STAT _MyStatusID)
{
	this->MyFDELogID[MyDevID] = _MyStatusID;
}
/**/
//--------------------------------------------------------------------------------------------------
// デバイス状態を取得します。
//--------------------------------------------------------------------------------------------------
_MyDEV_STAT		_MyDevice::GetDeviceInfo(_MyDEV_ID MyDevID)
{
	return	this->MyFDELogID[MyDevID];
}
/**/
//--------------------------------------------------------------------------------------------------
// 全ての管理デバイスが正常か？
//--------------------------------------------------------------------------------------------------
BOOL			_MyDevice::IsAllDeviceNormal(VOID)
{	
	for (INT iCount = 0; iCount < _MyDEV_ID::MY_DEVID_COUNT; iCount++) {
		//------------------------------------------------------------------------------------------
		// 「正常状態」以外のデバイスが存在する場合は、エラー
		//------------------------------------------------------------------------------------------
		if (this->MyFDELogID[iCount] !=  _MyDEV_STAT::MY_DEVSTAT_OPEN)		return MY_FALSE;
	}
	return 	MY_TRUE;
}
/**/
/*
*/
/**/
//--------------------------------------------------------------------------------------------------
// ＳＤ書込み用のバッファ：リアルタイムデータ（10Hz）保存領域・アクセスメソッド
//	FDRRingBuffInit				: Ringバッファを初期化する
//	FDRRingBuffPush				: Ringバッファ新規挿入
//	FDRRingBuffGetFirst			: Ringバッファに保存されているSD未書込みのメモリを取得する
//	FDRRingBuffSize				: Ringバッファに保存されているSD未書込みのデータ件数を取得する
//	FDRRingBuffShift			: SD書込みが完了したデータ件数を更新する
//--------------------------------------------------------------------------------------------------
/**/
//--------------------------------------------------------------------------------------------------
// Ringバッファを初期化する
//--------------------------------------------------------------------------------------------------
VOID			_MyDevice::FDRRingBuffInit(VOID)
{
	//----------------------------------------------------------------------------------------------
	// バッファをクリアする
	//----------------------------------------------------------------------------------------------
	this->ulRecordSeq				= (ULONG)0;							// FDRRecレコードシーケンス番号
	this->iUnConfirmedNum			= 0;								// SD書込み未完了レコード件数
	this->MyFDRRingBuff.clear();
}
/**/
//--------------------------------------------------------------------------------------------------
// RingBufferクラス内では未書き込み情報（索引）を提供していない為、追加実装
//--------------------------------------------------------------------------------------------------
INT				_MyDevice::FDRRingBuffSize(VOID)
{
	//----------------------------------------------------------------------------------------------
	// Ringバッファ内に保存されているデータレコード件数を返却する
	//----------------------------------------------------------------------------------------------
	return	this->MyFDRRingBuff.size();
}
/**/
//--------------------------------------------------------------------------------------------------
// RingBuffクラス内にある、SDデバイス・未書き込みの情報を取得する（最古にPUSHしたデータをスキャン）
//--------------------------------------------------------------------------------------------------
BOOL			_MyDevice::FDRRingBuffGetFirst(_MyFDRBodyRec *pMyFDRBodyRec)
{
	//----------------------------------------------------------------------------------------------
	// Ringバッファ内に保存されているデータレコードが存在する場合
	//----------------------------------------------------------------------------------------------
	BOOL	bRet = MY_FALSE;
	if (this->MyFDRRingBuff.size() > 0) {
		//------------------------------------------------------------------------------------------
		// Ringバッファ内の最古のデータをスキャンする（取得は実施しない）
		//------------------------------------------------------------------------------------------
		*pMyFDRBodyRec = this->MyFDRRingBuff.first();
		bRet = MY_TRUE;
	}
	return	bRet;
}
/**/
//--------------------------------------------------------------------------------------------------
// FDRRecバッファメモリ内の、未書き込みデータ件数を減算する（最古にPSUHしたデータを取り出す）
//--------------------------------------------------------------------------------------------------
VOID			_MyDevice::FDRRingBuffShift(VOID)
{
	this->MyFDRRingBuff.shift();									// Ringバッファから最古のデータを取得（削除）する。　
}
/**/
//--------------------------------------------------------------------------------------------------
// FDRRecバッファ・メモリ領域にデータを新規追加する
//--------------------------------------------------------------------------------------------------
BOOL		 	_MyDevice::FDRRingBuffPush(VOID)
{
	//----------------------------------------------------------------------------------------------
	// 自クラス管理内の最新FDRRecのシーケンス番号を設定
	//----------------------------------------------------------------------------------------------
	this->ulRecordSeq++;
	this->MyFDRBodyRecNow.SetRecordSeq(this->ulRecordSeq);

	//----------------------------------------------------------------------------------------------
	// Ringバッファの領域確保数を超えた場合、FALSEが返却される
	//----------------------------------------------------------------------------------------------
	BOOL	bRet = this->MyFDRRingBuff.push(this->MyFDRBodyRecNow);
	if (bRet != MY_TRUE) {
		//------------------------------------------------------------------------------------------
		// SD書き込み未済のメモリバッファ領域を超えてた。(SD書き込み処理が間に合っていない？）
		//------------------------------------------------------------------------------------------
		MY_TRACE(" MemoryError(%d) 未書込み情報を削除", this->MyFDRRingBuff.size());
	} 
	return	bRet;
}
/**/
#ifdef	MY_DEBUG_TASKINFO
//--------------------------------------------------------------------------------------------------
// 開発用のデータダンプ
//--------------------------------------------------------------------------------------------------
VOID		_MyDevice::DebugTaskInfo(CHAR *pszMsg) {
	CHAR	szBuff[512];										// 1task:40Byte
	vTaskList(szBuff);
	/*---
		runClient        X       7       4730    2			<---- Mail Task
		IDLE             R       0       129     3
		runServer        B       8       1965    1
		Tmr Svc          B       2       45      4
	---*/
	MY_LOG("\n/*--- vTaskList Start : %s\n", pszMsg);
	MY_LOG("TaskName\t\tStatus\tUrgency\tStack\tTaskID\n");
	MY_LOG("%s\n\n", szBuff);
}
#endif
/*-- End Of File --*/
