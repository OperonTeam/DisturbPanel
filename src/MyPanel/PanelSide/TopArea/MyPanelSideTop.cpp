//--------------------------------------------------------------------------------------------------
//  Project : Disturbing Information
//  Edition : WioTerminal with Extend multi LCD-Monitor
//  File path : src/MyPanel/PanelSide/TopArea/MyPanelSideTop.cpp
//  Copyright 2019, 2020, 2021, 2022, 2023 - OperonTeam
//--------------------------------------------------------------------------------------------------
#include "MyBase.h"
#include "MyDevice.h"
#include "MyJARVis.h"
#include "MyPanelSideTop.h"

//--------------------------------------------------------------------------------------------------
// システムデバイスマーカー・描画情報の位置
//	+-----++-----++-----+
//	| GPS || IMU || FDR |
//	+-----++-----++-----+
//	+-----++-----++-----+
//	| COM || BME || PAJ |
//	+-----++-----++-----+
//	+-----++-----++-----+
//	| RTC || AMG || ECU |
//	+-----++-----++-----+
//--------------------------------------------------------------------------------------------------
struct	_MyStatusTable {
	SHORT		sLabelPosX;
	SHORT		sLabelPosY;
	String		strName;
	_MyDEV_ID	MyDEVID;
	SHORT		sSystemStatus;
};
//---
MY_PRIVATE	_MyStatusTable	MyStatusTable[] = {
		(SHORT)0,	(SHORT)0,	F("GPS"), _MyDEV_ID::MY_DEVID_GPS, (SHORT)-1,
		(SHORT)0,	(SHORT)1,	F("NET"), _MyDEV_ID::MY_DEVID_NET, (SHORT)-1,
		(SHORT)0,	(SHORT)2,	F("RTC"), _MyDEV_ID::MY_DEVID_RTC, (SHORT)-1,
		//--
		(SHORT)1, 	(SHORT)0,	F("IMU"), _MyDEV_ID::MY_DEVID_IMU, (SHORT)-1,
		(SHORT)1, 	(SHORT)1,	F("BME"), _MyDEV_ID::MY_DEVID_BME, (SHORT)-1,
		(SHORT)1,	(SHORT)2,	F("AMG"), _MyDEV_ID::MY_DEVID_AMG, (SHORT)-1,
		//--
		(SHORT)2,	(SHORT)0,	F("FDR"), _MyDEV_ID::MY_DEVID_FDR, (SHORT)-1,
		(SHORT)2,	(SHORT)1,	F("PAJ"), _MyDEV_ID::MY_DEVID_PAJ, (SHORT)-1,
		(SHORT)2,	(SHORT)2,	F("HAL"), _MyDEV_ID::MY_DEVID_HAL, (SHORT)-1
};

//--------------------------------------------------------------------------------------------------
// クラスインスタンスの初期処理
//--------------------------------------------------------------------------------------------------
_MyPanelSideTop::_MyPanelSideTop()
{
}
/**/
//--------------------------------------------------------------------------------------------------
// クラスインスタンスの終了処理
//--------------------------------------------------------------------------------------------------
_MyPanelSideTop::~_MyPanelSideTop()
{
}
/**/
//--------------------------------------------------------------------------------------------------
// システムデバイスマーカーを描画する
//--------------------------------------------------------------------------------------------------
BOOL				_MyPanelSideTop::DrawSystemDevStatus(
_MyLGFX				*pMyLGFX,
BOOL				bDrawFlag,
_MyDevice			*pMyDevice)
{
	//----------------------------------------------------------------------------------------------
	// システムデバイス状態を取得して、現在描画中の情報とセンサー情報を比較します
	//----------------------------------------------------------------------------------------------
	for (INT iIdx = 0; iIdx < _MyDEV_ID::MY_DEVID_COUNT; iIdx++) {
		//------------------------------------------------------------------------------------------
		// 処理対象のシステムデバイス状態を取得する　
		//------------------------------------------------------------------------------------------
		_MyDEV_STAT	MyDEVStat = pMyDevice->GetDeviceInfo(MyStatusTable[iIdx].MyDEVID);

		//------------------------------------------------------------------------------------------
		// 取得したシステムデバイス状態を状態表示色に変換して、現描画オブジェクトの描画色と異なっているかチェックする　
		//------------------------------------------------------------------------------------------
		bDrawFlag += MyGlobalTool.IfSetDifferent(this->GetDevStatusColor(MyDEVStat), &(MyStatusTable[iIdx].sSystemStatus));
	}

	//----------------------------------------------------------------------------------------------
	// 再描画は必要？？
	//----------------------------------------------------------------------------------------------
	if (bDrawFlag) {
		//------------------------------------------------------------------------------------------
		// オフスクリーン・バッファ領域を作成する
		//------------------------------------------------------------------------------------------
		pMyLGFX->SpriteCreate(102, 102, 4);
		pMyLGFX->SpriteFillRect(0, 0, 102, 102, MY_PALETTE_BLACK);

		//------------------------------------------------------------------------------------------
		// 全システムデバイス状態を描画する
		//------------------------------------------------------------------------------------------
		for (INT iIdx = 0; iIdx < _MyDEV_ID::MY_DEVID_COUNT; iIdx++) {
			//--------------------------------------------------------------------------------------
			// サイドパネル（共通）・システムオブジェクトの描画を行う
			//	iX, iY
			//		+-------32------+
			//		|				|
			//		|	StringArea	32
			//		|				|
			//		+---------------+
			//---------------------------------------------------------------------------------------
			INT		iW = 34;
			INT		iH = 34;
			//---
			INT		iX = MyStatusTable[iIdx].sLabelPosX * iW;
			INT		iY = MyStatusTable[iIdx].sLabelPosY * iH;
			pMyLGFX->SpriteDrawStringFormat(MyStatusTable[iIdx].strName, iX + (iW/2), iY + 3, MY_LCDFONT_eSPI4, MyStatusTable[iIdx].sSystemStatus, 0.6, 1.4, textdatum_t::top_center);
			pMyLGFX->SpriteDrawRect(iX, iY, iW, iH, MY_PALETTE_DARKGREEN);
		}
		//------------------------------------------------------------------------------------------
		// オフスクリーンバッファに生成した領域を、ＬＣＤパネルに出力（描画）する
		//------------------------------------------------------------------------------------------
		pMyLGFX->SpritePush(0, 0, MY_TRUE);
	}
	return	MY_TRUE;
}
/**/
//--------------------------------------------------------------------------------------------------
// タイヤ表面温度サーモ情報（マトリクス）の描画を行う
//--------------------------------------------------------------------------------------------------
VOID				_MyPanelSideTop::DrawThermoMap(
_MyLGFX				*pMyLGFX,
BOOL				bDrawFlag,
_MyDevice			*pMyDevice)
{
	//----------------------------------------------------------------------------------------------
	// 動的オブジェクトを生成する（各種センサー情報）
	// カラーパレットが特殊なので、カラーマクロに意味は無い。
	//----------------------------------------------------------------------------------------------
	INT		iW = 102;
	INT		iH = 102;
	pMyLGFX->SpriteCreate(iW - 2, iH - 2, 8, MY_FALSE);
	pMyLGFX->SpriteSetConfig(MY_LCDFONT_eSPI4, MY_PALETTE_DARKGREEN, MY_PALETTE_BLACK, 1.0, 1.0, textdatum_t::top_left);
	//
	//----------------------------------------------------------------------------------------------
	// Theromoイメージを展開・描画する
	//----------------------------------------------------------------------------------------------
	for (INT iX = 0; iX < 50; iX++) {
		for (INT iY = 0; iY < 50; iY++) {
			//--------------------------------------------------------------------------------------
			// 指定位置のタイヤ表面温度情報を取得する
			// センサーから取得されるサーモ情報は、8x8の（マトリクス）情報ですが、ソフトウェアで有効
			// 分解能を向上させています。（実際に向上させているのは、のるLABさんです）
			// 但し、今回描画に利用する分解能は50x50pixcelです。
			//--------------------------------------------------------------------------------------
			CHAR	cTemp = pMyDevice->MyThermoMatrix.GetThermoHeatMap(iX + 3, iY + 3);
			//---
			//--------------------------------------------------------------------------------------
			// マトリクスを表示（サーモマトリクス情報1:パネル2pixcelに変換して描画します）
			//--------------------------------------------------------------------------------------
			pMyLGFX->SpriteFillRect((iX * 2) + 1, (iY * 2) + 1, 2, 2, cTemp);
		}
	}
	//----------------------------------------------------------------------------------------------
	// オフスクリーンバッファに生成した領域をＬＣＤパネルに出力（描画）する
	// バッファは解放しない
	//----------------------------------------------------------------------------------------------
	pMyLGFX->SpritePush(1, 1, MY_TRUE);
//---
	//----------------------------------------------------------------------------------------------
	// タイマーを設定する。
	//----------------------------------------------------------------------------------------------
	this->MyComTimer.InitTimer(3, 3000);
	//
	//----------------------------------------------------------------------------------------------
	// 描画タイミングを確認して、拡張オブジェクトの描画を行う
	//----------------------------------------------------------------------------------------------
MY_LOG("Timer => %d\n", this->MyComTimer.QueTimer());
//
	switch(this->MyComTimer.QueTimer()) {
		case	0:
{
			//------------------------------------------------------------------------------------------
			// １０秒毎にサーモ平均温度値を描画する
			//------------------------------------------------------------------------------------------
			pMyLGFX->SpriteCreate(iW, iH, 4, MY_TRUE);
			pMyLGFX->SpriteDrawRect( 0, 0, iW, iH, MY_PALETTE_DARKGREEN);				// 矩形をパレット色で塗り潰す
			pMyLGFX->SpriteFillRect( 1, 1, iW - 2, iH - 2, MY_PALETTE_YELLOW);			// 透過色を指定する（矩形をパレット色で塗り潰す）
			//---
			//------------------------------------------------------------------------------------------
			// 動的オブジェクトを生成する
			//------------------------------------------------------------------------------------------
			SHORT	sThermoAve = pMyDevice->MyFDRBodyRecNow.GetVehicieTireTempAve();		// 温度平均値を取得する
			pMyLGFX->SpriteSetConfig(MY_LCDFONT_eSPI7, MY_PALETTE_BLACK, MY_PALETTE_YELLOW, 1.6, 2.0, textdatum_t::middle_center);
			pMyLGFX->SpriteDrawNumber(sThermoAve, iW / 2, iH / 2);
			//---
			//------------------------------------------------------------------------------------------
			// オフスクリーンバッファに生成した領域をＬＣＤパネルに出力（描画）する
			//------------------------------------------------------------------------------------------
			pMyLGFX->SpritePush(0, 0, MY_TRUE, MY_PALETTE_YELLOW);
			break;
}
		default:
			break;
	}
}
/**/
//--------------------------------------------------------------------------------------------------
// 最上部の描画エリア
//	システムステータスマーカー
//	JARVisメッセージ表示領域
//--------------------------------------------------------------------------------------------------
// 期待する通常状態において全てのシステムステータスマーカーが正常値（OPEN)であるはずで、正常状態
// においてステータスマーカーの表示を割愛することでシステム状態の表示領域を拡大させます。
// 例えばトンネル通過時等、GPSデバイスのオンライン衛星数が検知出来ない場合、GPSデバイスは正常値(OPEN)
// 以外の状態を示しますが、この場合はシステムステータスマーカーを表示させます。
//--------------------------------------------------------------------------------------------------
VOID				_MyPanelSideTop::DrawSystemInfoMessage(
_MyLGFX				*pMyLGFX,
BOOL				bDrawFlag,
_MyDevice			*pMyDevice,
_MyJARVis			*pMyJARVis)
{
	INT	iW = MY_PANEL_MAX_WIDTH;								// オブジェクトの描画領域（Ｗ）
	INT iH = 102;												// オブジェクトの描画領域（Ｈ）
	INT	iX = 102;													// パネル上の表示位置（Ｘ）
	INT iY = 0;													// パネル上の表示位置（Ｙ）
//
	//----------------------------------------------------------------------------------------------
	// JARVisさまに状況を問い合わせて、メッセージが存在する場合
	//----------------------------------------------------------------------------------------------
	String	strMessage;
	bDrawFlag += pMyJARVis->QueJARVisMessage(pMyDevice, &strMessage);

	//----------------------------------------------------------------------------------------------
	// スクロール描画情報を初期化する
	//----------------------------------------------------------------------------------------------
	this->MyDrawScroll.SpriteDrawScrollStringInit(iW, iH, iX, iY, strMessage);
	if (bDrawFlag) {
		//------------------------------------------------------------------------------------------
		// スクロール描画処理を行う
		//------------------------------------------------------------------------------------------
		this->MyDrawScroll.SpriteDrawScrollStringRun(pMyLGFX);
	} else {
		//------------------------------------------------------------------------------------------
		// 描画位置固定で文字描画を行う
		//------------------------------------------------------------------------------------------
		this->MyDrawScroll.SpriteDrawSolidStringRun(pMyLGFX);
	}
}
/**/
//--------------------------------------------------------------------------------------------------
// 現在システム時刻描画
//--------------------------------------------------------------------------------------------------
VOID				_MyPanelSideTop::DrawSystemTime(
_MyLGFX				*pMyLGFX,
BOOL				bDrawFlag,
_MyDevice			*pMyDevice)
{
	//----------------------------------------------------------------------------------------------
	// 最新の日時情報を取得して、現在描画情報と同じ場合は処理をスキップする
	//----------------------------------------------------------------------------------------------
	DateTime	dtNow = pMyDevice->MyFDRBodyRecNow.GetGPSDateTime();
	BOOL	bRet = MyGlobalTool.IfSetDifferent(dtNow, &dtSystemMsgDateTime);
	if (bRet) {
		//------------------------------------------------------------------------------------------
		// 描画用の文字列を編集する（HH:MM / :SS）
		//------------------------------------------------------------------------------------------
		String	strHHMM = MyGlobalTool.ConvDateTime2StringHHMM(this->dtSystemMsgDateTime);
		String	strSS	= MyGlobalTool.ConvDateTime2StringSS(this->dtSystemMsgDateTime);
		//---
		//------------------------------------------------------------------------------------------
		// オフスクリーン・バッファ領域を作成する
		//------------------------------------------------------------------------------------------
		INT		iW = 218;
		INT		iH = 103;
		pMyLGFX->SpriteCreate(iW, iH, 4, MY_TRUE);
		//---
		//------------------------------------------------------------------------------------------
		// 動的オブジェクトを生成する
		//------------------------------------------------------------------------------------------
		pMyLGFX->SpriteDrawRect(0, 0, iW - 1, iH - 1, MY_PALETTE_DARKGREEN);		// 矩形をパレット色で塗り潰す
		pMyLGFX->SpriteDrawStringFormat("TIME",  iW - 3,	   3, MY_LCDFONT_eSPI4, MY_PALETTE_YELLOW, 0.8, 1.4, textdatum_t::top_right);
		pMyLGFX->SpriteDrawStringFormat(strHHMM,	   3, iH - 2, MY_LCDFONT_eSPI7, MY_PALETTE_YELLOW, 1.2, 2.0, textdatum_t::bottom_left);
		pMyLGFX->SpriteDrawStringFormat(strSS,	  iW - 3, iH - 2, MY_LCDFONT_eSPI7, MY_PALETTE_YELLOW, 0.5, 1.2, textdatum_t::bottom_right);
		//---
		//------------------------------------------------------------------------------------------
		// オフスクリーンバッファに生成した領域をＬＣＤパネルに出力（描画）する
		//------------------------------------------------------------------------------------------
		pMyLGFX->SpritePush(103, 0, MY_TRUE);
	}
}
/**/
//--------------------------------------------------------------------------------------------------
// 現在システム起動時間描画
//--------------------------------------------------------------------------------------------------
VOID				_MyPanelSideTop::DrawSystemUptime(
_MyLGFX				*pMyLGFX,
BOOL				bDrawFlag,
_MyJARVis			*pMyJARVis)
{
	//----------------------------------------------------------------------------------------------
	// 最新の日時情報を取得して、現在描画情報と同じ場合は処理をスキップする
	//----------------------------------------------------------------------------------------------
	TimeSpan	tsNow = pMyJARVis->MyJARVisAnalyze.GetElapsedTime();
	ULONG		ulNow = tsNow.totalseconds();
	BOOL	bRet = MyGlobalTool.IfSetDifferent(ulNow, &this->ulUpptimeTotalSecond);
	if (bRet) {
		//------------------------------------------------------------------------------------------
		// 描画用の文字列を編集する（MMM / :SS）
		//------------------------------------------------------------------------------------------
		String	strMMM	= MyGlobalTool.ConvTimeSpan2StringMMM(tsNow);
		String	strSS	= MyGlobalTool.ConvTimeSpan2StringSS(tsNow);
		//---
		//------------------------------------------------------------------------------------------
		// オフスクリーン・バッファ領域を作成する
		//------------------------------------------------------------------------------------------
		INT		iW = 218;
		INT		iH = 103;
		pMyLGFX->SpriteCreate(iW, iH, 4, MY_TRUE);
		//---
		//------------------------------------------------------------------------------------------
		// 動的オブジェクトを生成する
		//------------------------------------------------------------------------------------------
		pMyLGFX->SpriteDrawRect(0, 0, iW - 1, iH - 1, MY_PALETTE_DARKGREEN);
		pMyLGFX->SpriteDrawStringFormat("Uptime",	iW - 3,		  3, MY_LCDFONT_eSPI4, MY_PALETTE_DARKGREEN, 0.8, 1.4, textdatum_t::top_right);
		pMyLGFX->SpriteDrawStringFormat(strMMM,	iW - 80, iH - 2, MY_LCDFONT_eSPI7, MY_PALETTE_YELLOW,	 1.4, 2.0, textdatum_t::bottom_right);
		pMyLGFX->SpriteDrawStringFormat(strSS,		iW - 3,	 iH - 2, MY_LCDFONT_eSPI7, MY_PALETTE_YELLOW,	 1.0, 1.4, textdatum_t::bottom_right);
		//---
		//------------------------------------------------------------------------------------------
		// オフスクリーンバッファに生成した領域をＬＣＤパネルに出力（描画）する
		//------------------------------------------------------------------------------------------
		pMyLGFX->SpritePush(103, 0, MY_TRUE);
	}
}
/**/
//--------------------------------------------------------------------------------------------------
// デバイス状態表示ラベルの表示色を取得する（本来は文字色も変えたいところ）
//--------------------------------------------------------------------------------------------------
SHORT				_MyPanelSideTop::GetDevStatusColor(
_MyDEV_STAT			MyFDELogID)
{
	SHORT		sColor = MY_PALETTE_BLUE;
	switch(MyFDELogID) {
		case	_MyDEV_STAT::MY_DEVSTAT_NONE:			sColor = MY_PALETTE_WHITE;		break;
		case	_MyDEV_STAT::MY_DEVSTAT_OPEN:			sColor = MY_PALETTE_DARKGREEN;	break;
		case	_MyDEV_STAT::MY_DEVSTAT_FAIL:			sColor = MY_PALETTE_RED;		break;
		case	_MyDEV_STAT::MY_DEVSTAT_LOST:			sColor = MY_PALETTE_YELLOW;		break;
		default:
			break;
	}
	return	sColor;
}
/*-- End Of File --*/
