//--------------------------------------------------------------------------------------------------
//  Project : Disturbing Information
//  Edition : WioTerminal with Extend multi LCD-Monitor
//  File path : src/MyPanel/PanelSide/MyPanelSide.cpp
//  Copyright 2019, 2020, 2021, 2022, 2023 - OperonTeam
//--------------------------------------------------------------------------------------------------
#include "MyBase.h"
#include "MyDevice.h"
#include "MyJARVis.h"
#include "MyPanelSide.h"
//
//--------------------------------------------------------------------------------------------------
// クラスインスタンスの初期処理
//--------------------------------------------------------------------------------------------------
_MyPanelSide::_MyPanelSide()
{
}
/**/
//--------------------------------------------------------------------------------------------------
// クラスインスタンスの終了処理
//--------------------------------------------------------------------------------------------------
_MyPanelSide::~_MyPanelSide()
{
}
/**/
//--------------------------------------------------------------------------------------------------
// サイドパネル（上部）システム・マーカー描画処理
//--------------------------------------------------------------------------------------------------
VOID				_MyPanelSide::DrawTopSystemMarker(
BOOL				bDrawInitFlag,
_MyLGFX				*pMyLGFX,
_MyDevice			*pMyDevice)
{
	//----------------------------------------------------------------------------------------------
	// 全てのデバイスステータスは正常状態か？
	//----------------------------------------------------------------------------------------------
	if (pMyDevice->IsAllDeviceNormal() == MY_TRUE) {
		//------------------------------------------------------------------------------------------
		// 全て正常な場合は、サーモ・イメージを描画する
		//------------------------------------------------------------------------------------------
		this->MyPanelSideTop.DrawThermoMap(pMyLGFX, bDrawInitFlag, pMyDevice);
	} else {
		//------------------------------------------------------------------------------------------
		// 異常状態のデバイスが存在する場合、デバイス・ステータスマーカーを描画する
		//------------------------------------------------------------------------------------------
		this->MyPanelSideTop.DrawSystemDevStatus(pMyLGFX, bDrawInitFlag, pMyDevice);
	}
}
/**/
//--------------------------------------------------------------------------------------------------
// サイドパネル（上部）システム・マーカー描画処理
//--------------------------------------------------------------------------------------------------
BOOL				_MyPanelSide::DrawTopSystemConsole(
BOOL				bDrawInitFlag,
_MyLGFX				*pMyLGFX,
_MyDevice			*pMyDevice,
_MyJARVis			*pMyJARVis)
{
	//----------------------------------------------------------------------------------------------
	// 全てのデバイスステータスは正常状態か？
	//----------------------------------------------------------------------------------------------
	if (pMyDevice->IsAllDeviceNormal() == MY_TRUE) {
		//------------------------------------------------------------------------------------------
		// 全て正常な場合は、起動経過時間を描画する
		//------------------------------------------------------------------------------------------
		this->MyPanelSideTop.DrawSystemUptime(pMyLGFX, bDrawInitFlag, pMyJARVis);
	} else {
		//------------------------------------------------------------------------------------------
		// 異常状態のデバイスが存在する場合、起動経過時間を描画する
		//------------------------------------------------------------------------------------------
		this->MyPanelSideTop.DrawSystemUptime(pMyLGFX, bDrawInitFlag, pMyJARVis);
	}
	return	MY_FALSE;
}
/**/
//--------------------------------------------------------------------------------------------------
// サイドパネル（下部）システム状態・描画処理
//--------------------------------------------------------------------------------------------------
VOID				_MyPanelSide::DrawLowSystemArea(
BOOL				bDrawInitFlag,
_MyLGFX				*pMyLGFX,
_MyDevice			*pMyDevice,
_MyJARVis			*pMyJARVis)
{
	//----------------------------------------------------------------------------------------------
	// 現在走行状態は？（停車中か？）
	//----------------------------------------------------------------------------------------------
	CHAR	cDrivingCondition = pMyJARVis->MyJARVisAnalyze.QueJARVisDrivingCondition();
	if (MyGlobalTool.IfSetDifferent(cDrivingCondition, &this->cDrivingCondition)) {
		//------------------------------------------------------------------------------------------
		// 前回の状態と今回の走行状態が変わった場合は、描画指示フラグを強制オンにする
		//------------------------------------------------------------------------------------------
		bDrawInitFlag = MY_TRUE; 
		this->MyComTimer.InitTimer(3, 5000);
	}
	if (this->cDrivingCondition == _My_Driving_Condition::STATE_STOP) {
		//------------------------------------------------------------------------------------------
		// 現在停車中の場合、ＪＡＲＶｉｓ情報を描画する
		//------------------------------------------------------------------------------------------
		switch(this->MyComTimer.QueTimer(&bDrawInitFlag)) {
			case	0:
				//----------------------------------------------------------------------------------
				// 気象情報を描画する
				//----------------------------------------------------------------------------------
				this->MyPanelSideLowStop.DrawLogWeatherInfo(pMyLGFX, bDrawInitFlag, pMyDevice);
				break;
			case	1:
				//----------------------------------------------------------------------------------
				// ドライブ情報を描画する
				//----------------------------------------------------------------------------------
				this->MyPanelSideLowStop.DrawLogDriveInfo(pMyLGFX, bDrawInitFlag, pMyDevice, pMyJARVis);
				break;
			case	2:
				//----------------------------------------------------------------------------------
				// ＪＡＲｖｉｓ情報を描画する
				//----------------------------------------------------------------------------------
				this->MyPanelSideLowStop.DrawLogJARVisInfo(pMyLGFX, bDrawInitFlag, pMyDevice, pMyJARVis);
				break;
			case	3:
				//----------------------------------------------------------------------------------
				// Ｔｒｉｐ情報を描画する
				//----------------------------------------------------------------------------------
				this->MyPanelSideLowStop.DrawLogTripInfo(pMyLGFX, bDrawInitFlag, pMyDevice, pMyJARVis);
				break;
			default:
				break;
		}
	} else {
		//----------------------------------------------------------------------------------------------
		// 現在移動中の場合、速度遷移情報を描画する
		//----------------------------------------------------------------------------------------------
		this->MyPanelSideLowMove.DrawLogSpeedInfo(pMyLGFX, bDrawInitFlag, pMyDevice, pMyJARVis);
	}
}
/**/
/*-- End Of File --*/
